## Documentation/devicetree/bindings/memory-controllers/mediatek,smi-common.yaml
```yaml
# SPDX-License-Identifier: (GPL-2.0-only OR BSD-2-Clause)
# Copyright (c) 2020 MediaTek Inc.
%YAML 1.2
---
$id: http://devicetree.org/schemas/memory-controllers/mediatek,smi-common.yaml#
$schema: http://devicetree.org/meta-schemas/core.yaml#

title: SMI (Smart Multimedia Interface) Common

maintainers:
  - Yong Wu <yong.wu@mediatek.com>

description: |
  The hardware block diagram please check bindings/iommu/mediatek,iommu.yaml

  MediaTek SMI has three generations of HW architecture, here is the list
  which generation the SoCs use:
  generation 1: mt2701 and mt7623.
  generation 2: mt2712, mt6779, mt8167, mt8173, mt8183, mt8186, mt8188, mt8192 and mt8195.
  generation 3: mt6853.

  There's slight differences between the two SMI, for generation 2, the
  register which control the iommu port is at each larb's register base. But
  for generation 1, the register is at smi ao base(smi always on register
  base). Besides that, the smi async clock should be prepared and enabled for
  SMI generation 1 to transform the smi clock into emi clock domain, but that is
  not needed for SMI generation 2.

properties:
  compatible:
    oneOf:
      - enum:
          - mediatek,mt2701-smi-common
          - mediatek,mt2712-smi-common
          - mediatek,mt6779-smi-common
          - mediatek,mt6795-smi-common
          - mediatek,mt6853-smi-common
          - mediatek,mt6893-smi-common
          - mediatek,mt8167-smi-common
          - mediatek,mt8173-smi-common
          - mediatek,mt8183-smi-common
          - mediatek,mt8186-smi-common
          - mediatek,mt8188-smi-common-vdo
          - mediatek,mt8188-smi-common-vpp
          - mediatek,mt8192-smi-common
          - mediatek,mt8195-smi-common-vdo
          - mediatek,mt8195-smi-common-vpp
          - mediatek,mt8195-smi-sub-common
          - mediatek,mt8365-smi-common

      - description: for mt7623
        items:
          - const: mediatek,mt7623-smi-common
          - const: mediatek,mt2701-smi-common

      - description: MT6853 main common with generic fallback
        items:
          - const: mediatek,mt6853-smi-common
          - const: mediatek,smi-common

      - description: MT6853 main common with syscon
        items:
          - const: mediatek,mt6853-smi-common
          - const: syscon
          - const: mediatek,smi-common

      - description: MT6853 sub-common with generic fallback
        items:
          - const: mediatek,mt6853-smi-common
          - const: mediatek,smi-common
          - const: mediatek,smi-sub-common

      - description: MT6853 sub-common with syscon after generic fallback
        items:
          - const: mediatek,mt6853-smi-common
          - const: mediatek,smi-common
          - const: syscon
          - const: mediatek,smi-sub-common

      - description: MT6853 sub-common with syscon before generic fallback
        items:
          - const: mediatek,mt6853-smi-common
          - const: syscon
          - const: mediatek,smi-common
          - const: mediatek,smi-sub-common

  reg:
    maxItems: 1

  power-domains:
    maxItems: 1

  clocks:
    description: |
      apb and smi are mandatory. the async is only for generation 1 smi HW.
      gals(global async local sync) also is optional, see below.
    minItems: 2
    items:
      - description: apb is Advanced Peripheral Bus clock, It's the clock for
          setting the register.
      - description: smi is the clock for transfer data and command.
      - description: Either asynchronous clock to help transform the smi clock
          into the emi clock domain on Gen1 h/w, or the path0 clock of gals.
      - description: gals1 is the path1 clock of gals.

  clock-names:
    minItems: 2
    maxItems: 4

  mediatek,smi:
    $ref: /schemas/types.yaml#/definitions/phandle-array
    minItems: 1
    maxItems: 2
    description: |
      A phandle to an SMI common node. For MT6853, common-id 0 is the root and
      its mediatek,smi phandles point to dependent children. Nodes carrying the
      mediatek,smi-sub-common compatible use this property to point upstream
      to their parent; the explicit compatible distinguishes that direction.
      Parent chains may contain multiple sub-common nodes and terminate at the
      unmarked root common. The ACK IOMMU integration must follow marked parent
      links with a bounded traversal and reject cycles or a marked node without
      a parent when that node is reached from a LARB. The root's two raw child
      phandles are represented as one phandle-array entry because they have no
      specifier cells; the ACK driver enforces the exact count.

  mediatek,common-id:
    $ref: /schemas/types.yaml#/definitions/uint32
    minimum: 0
    maximum: 7
    description: |
      Hardware common ID, required for MT6853 SMI common nodes. ID 0 is the
      unmarked root common; IDs 1 through 7 are sub-commons and must include
      the mediatek,smi-sub-common compatible. This marker identifies parent
      links for the ACK IOMMU parser without confusing root-to-child links.

required:
  - compatible
  - reg
  - power-domains
  - clocks
  - clock-names

allOf:
  - if:  # only for gen1 HW
      properties:
        compatible:
          contains:
            enum:
              - mediatek,mt2701-smi-common
    then:
      properties:
        clocks:
          minItems: 3
          maxItems: 3
        clock-names:
          items:
            - const: apb
            - const: smi
            - const: async

  - if:  # only for MT8195 sub-common
      properties:
        compatible:
          contains:
            const: mediatek,mt8195-smi-sub-common
    then:
      required:
        - mediatek,smi
      properties:
        clocks:
          minItems: 3
          maxItems: 3
        clock-names:
          items:
            - const: apb
            - const: smi
            - const: gals0

    else:
      if:
        properties:
          compatible:
            contains:
              const: mediatek,mt6853-smi-common
      then: {}
      else:
        properties:
          mediatek,smi: false

  - if:
      properties:
        compatible:
          contains:
            const: mediatek,mt6853-smi-common
    then:
      required:
        - mediatek,common-id
      properties:
        clocks:
          minItems: 4
          maxItems: 4
        clock-names:
          items:
            - const: apb
            - const: smi
            - const: gals0
            - const: gals1
      allOf:
        - if:
            properties:
              mediatek,common-id:
                const: 0
          then:
            required:
              - mediatek,smi
            properties:
              mediatek,smi:
                minItems: 1
                maxItems: 2
              compatible:
                not:
                  contains:
                    const: mediatek,smi-sub-common
        - if:
            properties:
              mediatek,common-id:
                enum: [1, 2, 3, 4, 5, 6, 7]
          then:
            properties:
              compatible:
                allOf:
                  - contains:
                      const: mediatek,smi-common
                  - contains:
                      const: mediatek,smi-sub-common
        - if:
            properties:
              mediatek,common-id:
                enum: [3, 4, 5, 6, 7]
          then:
            required:
              - mediatek,smi
            properties:
              mediatek,smi:
                maxItems: 1
        - if:
            properties:
              mediatek,common-id:
                enum: [1, 2]
          then:
            properties:
              mediatek,smi: false

  - if:  # HW that have gals
      properties:
        compatible:
          enum:
            - mediatek,mt6779-smi-common
            - mediatek,mt8183-smi-common
            - mediatek,mt8186-smi-common
            - mediatek,mt8192-smi-common
            - mediatek,mt8195-smi-common-vdo
            - mediatek,mt8195-smi-common-vpp
            - mediatek,mt8365-smi-common
            - mediatek,mt6853-smi-common

    then:
      properties:
        clocks:
          minItems: 4
          maxItems: 4
        clock-names:
          items:
            - const: apb
            - const: smi
            - const: gals0
            - const: gals1

  - if:  # for gen2 HW that don't have gals
      properties:
        compatible:
          enum:
            - mediatek,mt2712-smi-common
            - mediatek,mt6795-smi-common
            - mediatek,mt8167-smi-common
            - mediatek,mt8173-smi-common

    then:
      properties:
        clocks:
          minItems: 2
          maxItems: 2
        clock-names:
          items:
            - const: apb
            - const: smi

additionalProperties: false

examples:
  - |+
    #include <dt-bindings/clock/mt8173-clk.h>
    #include <dt-bindings/power/mt8173-power.h>

    smi_common: smi@14022000 {
            compatible = "mediatek,mt8173-smi-common";
            reg = <0x14022000 0x1000>;
            power-domains = <&scpsys MT8173_POWER_DOMAIN_MM>;
            clocks = <&mmsys CLK_MM_SMI_COMMON>,
                     <&mmsys CLK_MM_SMI_COMMON>;
            clock-names = "apb", "smi";
    };
```

## Documentation/devicetree/bindings/memory-controllers/mediatek,smi-larb.yaml
```yaml
# SPDX-License-Identifier: (GPL-2.0-only OR BSD-2-Clause)
# Copyright (c) 2020 MediaTek Inc.
%YAML 1.2
---
$id: http://devicetree.org/schemas/memory-controllers/mediatek,smi-larb.yaml#
$schema: http://devicetree.org/meta-schemas/core.yaml#

title: SMI (Smart Multimedia Interface) Local Arbiter

maintainers:
  - Yong Wu <yong.wu@mediatek.com>

description: |
  The hardware block diagram please check bindings/iommu/mediatek,iommu.yaml

properties:
  compatible:
    oneOf:
      - enum:
          - mediatek,mt2701-smi-larb
          - mediatek,mt2712-smi-larb
          - mediatek,mt6779-smi-larb
          - mediatek,mt6795-smi-larb
          - mediatek,mt6853-smi-larb
          - mediatek,mt6893-smi-larb
          - mediatek,mt8167-smi-larb
          - mediatek,mt8173-smi-larb
          - mediatek,mt8183-smi-larb
          - mediatek,mt8186-smi-larb
          - mediatek,mt8188-smi-larb
          - mediatek,mt8192-smi-larb
          - mediatek,mt8195-smi-larb

      - description: for mt7623
        items:
          - const: mediatek,mt7623-smi-larb
          - const: mediatek,mt2701-smi-larb

      - items:
          - const: mediatek,mt8365-smi-larb
          - const: mediatek,mt8186-smi-larb

  reg:
    maxItems: 1

  clocks:
    description: |
      apb and smi are mandatory. gals(global async local sync) is optional.
    minItems: 2
    items:
      - description: apb is Advanced Peripheral Bus clock, It's the clock for
          setting the register.
      - description: smi is the clock for transfer data and command.
      - description: the path0 clock for gals.
      - description: the path1 clock for gals.

  clock-names:
    minItems: 2
    maxItems: 4

  power-domains:
    maxItems: 1

  mediatek,smi:
    $ref: /schemas/types.yaml#/definitions/phandle
    description: |
      A phandle to the SMI common or sub-common for this LARB. The ACK 6.18
      IOMMU parser follows mediatek,smi parent links only while the referenced
      node has the mediatek,smi-sub-common compatible, stopping at the
      unmarked root common. Traversal must be bounded and reject cycles or a
      marked node without a parent; every LARB in one M4U's larbs list must
      resolve to the same root. This schema cannot validate phandle targets
      or those cross-node constraints; the board DT must satisfy them.

  mediatek,larb-id:
    $ref: /schemas/types.yaml#/definitions/uint32
    minimum: 0
    maximum: 31
    description: |
      The hardware ID of this LARB. It is required for MT6853 so the IOMMU
      component bind assigns the ID used to index the SMI tuning table.
      Other SoCs only need it when the ID is not consecutive from the M4U's
      point of view.

required:
  - compatible
  - reg
  - clocks
  - clock-names
  - power-domains

allOf:
  - if:  # HW has gals
      properties:
        compatible:
          enum:
            - mediatek,mt8183-smi-larb
            - mediatek,mt8186-smi-larb
            - mediatek,mt8188-smi-larb
            - mediatek,mt8195-smi-larb

    then:
      properties:
        clocks:
          minItems: 2
          maxItems: 3
        clock-names:
          minItems: 2
          items:
            - const: apb
            - const: smi
            - const: gals
          additionalItems: false

    else:
      if:
        properties:
          compatible:
            contains:
              const: mediatek,mt6853-smi-larb
      then:
        required:
          - mediatek,smi
          - mediatek,larb-id
        properties:
          mediatek,larb-id:
            maximum: 20
          clocks:
            oneOf:
              - minItems: 2
                maxItems: 2
              - minItems: 4
                maxItems: 4
          clock-names:
            oneOf:
              - items:
                  - const: apb
                  - const: smi
                additionalItems: false
              - items:
                  - const: apb
                  - const: smi
                  - const: gals0
                  - const: gals1
                additionalItems: false
      else:
        properties:
          clocks:
            minItems: 2
            maxItems: 2
          clock-names:
            items:
              - const: apb
              - const: smi

  - if:
      properties:
        compatible:
          contains:
            enum:
              - mediatek,mt2701-smi-larb
              - mediatek,mt2712-smi-larb
              - mediatek,mt6779-smi-larb
              - mediatek,mt8186-smi-larb
              - mediatek,mt8188-smi-larb
              - mediatek,mt8192-smi-larb
              - mediatek,mt8195-smi-larb
              - mediatek,mt6853-smi-larb

    then:
      required:
        - mediatek,larb-id

additionalProperties: false

examples:
  - |+
    #include <dt-bindings/clock/mt8173-clk.h>
    #include <dt-bindings/power/mt8173-power.h>

    larb1: larb@16010000 {
      compatible = "mediatek,mt8173-smi-larb";
      reg = <0x16010000 0x1000>;
      mediatek,smi = <&smi_common>;
      power-domains = <&scpsys MT8173_POWER_DOMAIN_VDEC>;
      clocks = <&vdecsys CLK_VDEC_CKEN>,
               <&vdecsys CLK_VDEC_LARB_CKEN>;
      clock-names = "apb", "smi";
    };
```

## Documentation/devicetree/bindings/regulator/ti,lm36273.yaml
```yaml
# SPDX-License-Identifier: (GPL-2.0-only OR BSD-2-Clause)
%YAML 1.2
---
$id: http://devicetree.org/schemas/regulator/ti,lm36273.yaml#
$schema: http://devicetree.org/meta-schemas/core.yaml#

title: TI LM36273 backlight and LCD bias controller

maintainers:
  - devicetree@vger.kernel.org

description: |
  The LM36273 controls an LCD backlight and provides positive and negative
  bias rails. The bias output is represented by a regulator subnode.

properties:
  compatible:
    oneOf:
      - const: ti,lm36273
      - items:
          - const: mediatek,i2c_lcd_bias
          - const: ti,lm36273

  reg:
    maxItems: 1

  bias:
    type: object
    $ref: regulator.yaml#
    unevaluatedProperties: false

required:
  - compatible
  - reg
  - bias

additionalProperties: false

examples:
  - |
    i2c {
        #address-cells = <1>;
        #size-cells = <0>;

        backlight@11 {
            compatible = "ti,lm36273";
            reg = <0x11>;

            bias {
                regulator-name = "panel-bias";
                regulator-min-microvolt = <5500000>;
                regulator-max-microvolt = <5500000>;
            };
        };
    };
```
