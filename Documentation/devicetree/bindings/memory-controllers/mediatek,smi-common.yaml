## Documentation/devicetree/bindings/ufs/mediatek,ufs.yaml
```yaml
# SPDX-License-Identifier: GPL-2.0-only OR BSD-2-Clause
%YAML 1.2
---
$id: http://devicetree.org/schemas/ufs/mediatek,ufs.yaml#
$schema: http://devicetree.org/meta-schemas/core.yaml#

title: Mediatek Universal Flash Storage (UFS) Controller

maintainers:
  - Stanley Chu <stanley.chu@mediatek.com>

properties:
  compatible:
    enum:
      - mediatek,mt8183-ufshci
      - mediatek,mt8192-ufshci
      - mediatek,mt8195-ufshci
      - mediatek,mt6853-ufshci

  clocks:
    minItems: 1
    maxItems: 8

  clock-names:
    minItems: 1
    maxItems: 8

  freq-table-hz:
    true

  interrupts:
    $ref: /schemas/ufs/ufs-common.yaml#/properties/interrupts

  phys:
    maxItems: 1

  reg:
    maxItems: 1

  vcc-supply: true

  vcc-fixed-regulator:
    $ref: /schemas/types.yaml#/definitions/flag
    description: Legacy MTK VCC metadata retained in shipped MT6853 DT; ignored by ACK.

  vcc-voltage:
    $ref: /schemas/types.yaml#/definitions/uint32
    description: Legacy MTK VCC metadata retained in shipped MT6853 DT; ignored by ACK.

  vcc-voltage-plus:
    $ref: /schemas/types.yaml#/definitions/uint32
    description: Legacy MTK VCC metadata retained in shipped MT6853 DT; ignored by ACK.

  mediatek,perf-crypto-vcore:
    $ref: /schemas/types.yaml#/definitions/uint32
    minimum: 0
    maximum: 3
    description:
      Vendor VCORE OPP index for crypto performance transitions. ACK does not
      implement the PM_QOS_VCORE_OPP provider; this property is metadata only.

  mediatek,ufs-disable-mcq:
    $ref: /schemas/types.yaml#/definitions/flag
    description: The mask to disable MCQ (Multi-Circular Queue) for UFS host.

  mediatek,auto-hibern8-timer:
    $ref: /schemas/types.yaml#/definitions/uint32
    maximum: 102300
    description:
      Auto-Hibern8 timeout in milliseconds. Zero leaves the driver default.

  mediatek,infracfg-ao:
    $ref: /schemas/types.yaml#/definitions/phandle
    description:
      Phandle to the MT6853 infracfg_ao syscon containing the UFS reset
      registers.

  mediatek,rpm-autosuspend-delay:
    $ref: /schemas/types.yaml#/definitions/uint32
    minimum: 1
    maximum: 2147483647
    description:
      Runtime autosuspend delay for the UFS host in milliseconds.

  mediatek,rpm-enable:
    $ref: /schemas/types.yaml#/definitions/uint32
    enum: [0, 1]
    description: Enable runtime autosuspend for the UFS host.

  mediatek,rpm-level:
    $ref: /schemas/types.yaml#/definitions/uint32
    maximum: 5
    description: UFS runtime power-management level.

  mediatek,spm-level:
    $ref: /schemas/types.yaml#/definitions/uint32
    maximum: 5
    description: UFS system-suspend power-management level.

required:
  - compatible
  - clocks
  - clock-names
  - reg
  - vcc-supply

unevaluatedProperties: false

allOf:
  - $ref: ufs-common.yaml

  - if:
      properties:
        compatible:
          contains:
            const: mediatek,mt8195-ufshci
    then:
      properties:
        clocks:
          minItems: 8
        clock-names:
          items:
            - const: ufs
            - const: ufs_aes
            - const: ufs_tick
            - const: unipro_sysclk
            - const: unipro_tick
            - const: unipro_mp_bclk
            - const: ufs_tx_symbol
            - const: ufs_mem_sub
    else:
      if:
        properties:
          compatible:
            contains:
              const: mediatek,mt6853-ufshci
      then:
        properties:
          clocks:
            minItems: 7
            maxItems: 7
          clock-names:
            items:
              - const: ufs-clk
              - const: ufs-unipro-clk
              - const: ufs-mp-clk
              - const: ufs-crypto-clk
              - const: ufs-vendor-crypto-clk-mux
              - const: ufs-vendor-crypto-normal-parent-clk
              - const: ufs-vendor-crypto-perf-parent-clk
        required:
          - mediatek,infracfg-ao
      else:
        properties:
          clocks:
            maxItems: 1
          clock-names:
            items:
              - const: ufs
        required:
          - phys

examples:
  - |
    #include <dt-bindings/clock/mt8183-clk.h>
    #include <dt-bindings/interrupt-controller/arm-gic.h>

    soc {
        #address-cells = <2>;
        #size-cells = <2>;

        ufs@ff3c0000 {
            compatible = "mediatek,mt8183-ufshci";
            reg = <0 0x11270000 0 0x2300>;
            interrupts = <GIC_SPI 104 IRQ_TYPE_LEVEL_LOW>;
            phys = <&ufsphy>;

            clocks = <&infracfg_ao CLK_INFRA_UFS>;
            clock-names = "ufs";
            freq-table-hz = <0 0>;

            vcc-supply = <&mt_pmic_vemc_ldo_reg>;
        };
    };
  - |
    #include <dt-bindings/interrupt-controller/arm-gic.h>

    / {
        #address-cells = <2>;
        #size-cells = <2>;
        interrupt-parent = <&gic>;

        gic: interrupt-controller {
            interrupt-controller;
            #interrupt-cells = <3>;
        };

        infracfg_ao: syscon@10001000 {
            compatible = "mediatek,infracfg_ao",
                         "mediatek,mt6853-infracfg_ao",
                         "syscon";
            reg = <0 0x10001000 0 0x1000>;
            #clock-cells = <1>;
        };

        topckgen: clock-controller@10000000 {
            compatible = "mediatek,topckgen",
                         "mediatek,mt6853-topckgen",
                         "syscon";
            reg = <0 0x10000000 0 0x1000>;
            #clock-cells = <1>;
        };

        ufs_vcc: regulator-ufs-vcc {
            compatible = "regulator-fixed";
            regulator-name = "ufs-vcc";
            regulator-min-microvolt = <3000000>;
            regulator-max-microvolt = <3000000>;
        };

        ufs@11270000 {
            compatible = "mediatek,mt6853-ufshci";
            reg = <0 0x11270000 0 0x2300>;
            interrupts = <GIC_SPI 105 IRQ_TYPE_LEVEL_LOW>;
            clocks = <&infracfg_ao 0x4c>,
                     <&infracfg_ao 0x3d>,
                     <&infracfg_ao 0x3f>,
                     <&infracfg_ao 0x4d>,
                     <&topckgen 0xc7>,
                     <&topckgen 0x26>,
                     <&topckgen 0x02>;
            clock-names = "ufs-clk", "ufs-unipro-clk", "ufs-mp-clk",
                          "ufs-crypto-clk",
                          "ufs-vendor-crypto-clk-mux",
                          "ufs-vendor-crypto-normal-parent-clk",
                          "ufs-vendor-crypto-perf-parent-clk";
            freq-table-hz = <0 0 0 0 0 0 0 0 0 0 0 0 0 0>;
            vcc-supply = <&ufs_vcc>;
            mediatek,infracfg-ao = <&infracfg_ao>;
            mediatek,auto-hibern8-timer = <10>;
            mediatek,spm-level = <3>;
            mediatek,rpm-enable = <1>;
            mediatek,rpm-autosuspend-delay = <2000>;
            mediatek,rpm-level = <3>;
        };
    };
```

## drivers/dma-buf/heaps/Kconfig
```kconfig
config DMABUF_HEAPS_SYSTEM
	tristate "DMA-BUF System Heap"
	depends on DMABUF_HEAPS
	help
	  Choose this option to enable the system dmabuf heap. The system heap
	  is backed by pages from the buddy allocator. If in doubt, say Y.

config DMABUF_HEAPS_SYSTEM_MTK_ALIASES
	bool "MediaTek mtk_mm heap aliases of the system heap"
	depends on DMABUF_HEAPS_SYSTEM
	help
	  Register "mtk_mm" and "mtk_mm-uncached" as aliases of the system
	  and system-uncached heaps for prebuilt MediaTek vendor userspace
	  (Codec2 c2store, gralloc, camera HAL). Can be disabled at boot with
	  system_heap.mtk_aliases=0.

config DMABUF_HEAPS_CMA
	tristate "DMA-BUF CMA Heap"
	depends on DMABUF_HEAPS && DMA_CMA
	help
	  Choose this option to enable dma-buf CMA heap. This heap is backed
	  by the Contiguous Memory Allocator (CMA). If your system has these
	  regions, you should say Y here.

config DMABUF_HEAPS_CMA_LEGACY
	bool "Legacy DMA-BUF CMA Heap"
	default y
	depends on DMABUF_HEAPS_CMA
	help
	  Add a duplicate CMA-backed dma-buf heap with legacy naming derived
	  from the CMA area's devicetree node, or "reserved" if the area is not
	  defined in the devicetree. This uses the same underlying allocator as
	  CONFIG_DMABUF_HEAPS_CMA.
```

## drivers/media/platform/mediatek/mt6853-vcodec/Kconfig
```kconfig
# SPDX-License-Identifier: GPL-2.0-only
config VIDEO_MEDIATEK_MT6853_VCU_ENC
	bool "MediaTek MT6853 vendor VCU encoder"
	depends on V4L_MEM2MEM_DRIVERS && VIDEO_DEV
	depends on ARCH_MEDIATEK && MTK_IOMMU && MTK_SMI
	depends on MTK_VCU
	depends on !VIDEO_MEDIATEK_VCODEC
	select VIDEOBUF2_DMA_CONTIG
	select V4L2_MEM2MEM_DEV
	help
	  MT6853 V4L2 memory-to-memory encoder using the Android vendor vpud
	  daemon through /dev/vcu. Provides the vendor-private controls and
	  VCU IPI protocol needed by c2.mtk AVC, HEVC and HEIF encoders.
	  Requires mtk_vcu.enable=1 and a matching vendor vpud installation.
```

## drivers/misc/mtk-cam/Kconfig
```kconfig
# SPDX-License-Identifier: GPL-2.0-only

config MTK_CAM_PORT
	bool "MediaTek MT6853 legacy camera stack (imgsensor/seninf) port"
	depends on OF && I2C && REGULATOR && PINCTRL && PM && PROC_FS
	depends on ARM64 && COMMON_CLK && (ARCH_MEDIATEK || COMPILE_TEST)
	depends on DMA_SHARED_BUFFER && PM_GENERIC_DOMAINS
	select REGMAP_I2C
	default n
	help
	  Port of the 4.14 MediaTek legacy camera kernel interface used by
	  the stock MT6853 camera HAL (camerahalserver, libcam.halsensor):

	    /dev/kd_camera_hw  image sensor power, I2C and feature control
	    /dev/seninf        sensor interface clocks, MCLK and register map

	  plus the sensor drivers of the Redmi Note 9T (s5kgm1st, s5k3l6,
	  ov02b10, ov8856, hi259) and the FAN53870/PM8008 camera LDO PMICs on
	  i2c9, and the read-only camera EEPROM nodes /dev/camera_eepromN
	  (cam_cal v2) and the DW9800W main lens actuator /dev/MAINAF.

	  It also contains the ISP P1 driver /dev/camera-isp (camsys raw
	  A/B and camsv2-7), powered through the cam power domains and the
	  M4U (mtk_iommu) larbs 13/16/17. It needs a second switch:

	    mtk_cam.hw=1 mtk_cam.isp=1

	  The ISP P2 path used for preview and capture has its own switches,
	  each of them off by default:

	    mtk_cam.dip=1    /dev/camera-dip (DIP, MFB/MSS/MSF), imgsys
	                     power through the larb9/larb11 iommus
	    mtk_cam.mdp=1    /dev/mtk_mdp and /dev/mtk_mdp_limit: the 4.14
	                     CMDQ "meta" ABI of libdpframework, executed on
	                     the mainline GCE mailbox (needs MTK_CMDQ=y)
	    mtk_cam.flash=1  /dev/flashlight: the 4.14 flashlight-core ABI on
	                     top of the MT6360 LED-class flash LED (needs
	                     LEDS_CLASS_FLASH=y and LEDS_MT6360)

	  CCU is not part of this port; the HAL must be told not to use it
	  (vendor.debug.ccu_mgr_ccu.enable=0).

	  Nothing is registered and no camera hardware is touched unless the
	  kernel is booted with

	    mtk_cam.hw=1

	  The device tree needs arch/arm64/boot/dts/mediatek/
	  mt6853-camera.dtsi.

	  If unsure, say N.
```

## drivers/misc/mtk-ccci/Kconfig
```kconfig
# SPDX-License-Identifier: GPL-2.0-only

config MTK_CCCI
	bool "MediaTek MT6853 CCCI modem (MD1) driver"
	depends on ARM64 && OF && OF_RESERVED_MEM && NET
	depends on PM && PM_GENERIC_DOMAINS && MFD_SYSCON && POWER_SUPPLY
	depends on ARCH_MEDIATEK || COMPILE_TEST
	default n
	help
	  Port of the MediaTek eccci stack (CCIF control channel, DPMAIF
	  data path, ccmni network devices, /dev/ccci_* character devices,
	  /sys/kernel/ccci and the MD1 boot state machine) used by the
	  vendor ccci_mdinit, ccci_fsd and rild userspace.

	  Nothing is registered unless the kernel is booted with

	    mtk_ccci.hw=1

	  Adding mtk_ccci.power=0 registers the devices and device nodes
	  but refuses to power or start the modem. The device tree needs
	  the nodes from arch/arm64/boot/dts/mediatek/mt6853-modem.dtsi.
	  Must be built in.

	  If unsure, say N.
```

## drivers/misc/mtk-consys/Kconfig
```kconfig
# SPDX-License-Identifier: GPL-2.0-only

config MTK_CONSYS_PORT
	bool "MediaTek MT6853 connectivity (consys) port, stage 1"
	depends on OF && (ARCH_MEDIATEK || COMPILE_TEST)
	default n
	help
	  Stage 1 of the MT6853 connectivity subsystem port. It only creates
	  /dev/wmtdetect so that the vendor wmt_loader can finish its
	  detection handshake and set vendor.connsys.driver.ready. The
	  connectivity hardware (power, clocks, firmware, Wi-Fi, Bluetooth,
	  GPS, FM) is not touched and not functional yet.

	  It does nothing unless the device tree has a
	  "mediatek,mt6853-consys" node. Must be built in, because the
	  loader runs before any module is loaded.

	  If unsure, say N.

config MTK_CONSYS_WMT
	bool "MediaTek MT6853 consys WMT/STP core (hardware bring-up)"
	depends on MTK_CONSYS_PORT && ARM64 && PM && REGULATOR && MFD_MT6397
	depends on THERMAL_OF && PINCTRL && GPIOLIB_LEGACY && OF_RESERVED_MEM
	depends on MMC=y && FW_LOADER=y && PROC_FS
	default n
	help
	  Stage 2 of the MT6853 connectivity port: the vendor WMT/STP core
	  with its consys power-up, A-die detection, firmware download and
	  /dev/stpwmt, adapted to mainline. It powers the chip up at boot.
	  Booting with

	    mtk_consys.hw=0

	  leaves the hardware untouched and keeps the stage 1 handshake in
	  charge. mtk_consys.power=0 registers the drivers without ever
	  powering the chip.

	  The device tree needs the memory-region, pmic and regulator
	  supplies of the consys node (arch/arm64/boot/dts/mediatek/
	  mt6853-conn.dtsi). The firmware is loaded from the path set by
	  firmware_class.path.

	  If unsure, say N.

source "drivers/misc/mtk-consys/bt/Kconfig"
source "drivers/misc/mtk-consys/gps/Kconfig"
source "drivers/misc/mtk-consys/wlan/Kconfig"
```

## drivers/misc/mtk-consys/bt/Kconfig
```kconfig
# SPDX-License-Identifier: GPL-2.0-only

config MTK_CONSYS_BT
	bool "MediaTek MT6853 consys Bluetooth (/dev/stpbt)"
	depends on MTK_CONSYS_WMT
	default n
	help
	  The /dev/stpbt character device used by the vendor Bluetooth HAL:
	  H4 HCI packets carried over the WMT/STP core. The chip is powered
	  and the Bluetooth firmware is started when the node is opened and
	  powered down again on the last close. Nothing happens at boot, and
	  nothing at all unless the kernel command line has mtk_consys.hw=1.

	  The node is only created once the vendor wmt_loader has initialised
	  the connectivity drivers. mtk_stpbt.enable=0 on the kernel command
	  line keeps the node from being created.

	  If unsure, say N.
```

## drivers/misc/mtk-consys/gps/Kconfig
```kconfig
# SPDX-License-Identifier: GPL-2.0-only

config MTK_CONSYS_GPS
	bool "MediaTek MT6853 consys GNSS (/dev/stpgps, gps_emi, gps_pwr)"
	depends on MTK_CONSYS_WMT
	default n
	help
	  The /dev/stpgps character device used by the vendor mnld GNSS
	  daemon: the GNSS data stream carried over the WMT/STP core. The
	  GNSS function is powered through WMT on the first open and powered
	  down again on the last close. Nothing happens at boot.

	  /dev/gps_emi maps the GNSS window of the consys reserved EMI for
	  mnld and /dev/gps_pwr reports the connsys low-battery level.

	  The node is only created once the vendor wmt_loader has initialised
	  the connectivity drivers. mtk_stpgps.enable=0 on the kernel command
	  line keeps the node from being created.

	  If unsure, say N.
```

## drivers/misc/mtk-consys/wlan/Kconfig
```kconfig
# SPDX-License-Identifier: GPL-2.0-only

config MTK_CONSYS_WLAN
	bool "MediaTek MT6853 consys Wi-Fi (gen4m, AXI/SOC2)"
	depends on MTK_CONSYS_WMT && CFG80211=y && NET
	select WIRELESS_EXT
	select WEXT_PRIV
	default n
	help
	  The vendor gen4m WLAN driver for the MT6853 connectivity
	  combo chip, built in and adapted to mainline cfg80211.

	  It stays dormant until the WMT core is enabled (mtk_consys.hw=1)
	  and user space writes 1 to /dev/wmtWifi; probing only maps the
	  CSR window and registers callbacks with WMT. The chip is powered
	  and the firmware downloaded only on that write.

	  If unsure, say N.
```
