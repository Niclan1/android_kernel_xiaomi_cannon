## drivers/misc/mtk-ion-compat/Kconfig
```kconfig
# SPDX-License-Identifier: GPL-2.0-only

config MTK_ION_COMPAT
	bool "Legacy MediaTek /dev/ion ABI on top of DMA-BUF heaps"
	depends on DMABUF_HEAPS && DMABUF_HEAPS_SYSTEM && ARM64
	default n
	help
	  Provides /dev/ion with the handle based ION ABI of the MediaTek
	  4.14 kernel (ALLOC/FREE/MAP/SHARE/IMPORT/SYNC/CUSTOM/HEAP_QUERY)
	  for prebuilt vendor blobs (camera HAL, dpframework). Every legacy
	  heap that is not secure is served by the "system" DMA-BUF heap
	  (or "system-uncached" for uncached requests). Secure/protected
	  heaps are refused. ION_MM_GET_IOVA is served for the M4U
	  camera/MDP region when the DT has a mediatek,mtk-ion-compat-iova
	  node.

	  WARNING: Codec2 (libcodec2_vndk, system and vendor) picks its
	  legacy ION allocator purely because stat("/dev/ion") succeeds and
	  then crashes in client processes (NULL component store). Before
	  enabling this, the ROM must either set debug.c2.use_dmabufheaps=1
	  or label /dev/ion with a type that only the camera HAL may
	  getattr/open (preferably both).

	  The device is only registered when the kernel is booted with

	    mtk_ion_compat.enable=1

	  If unsure, say N.
```

## drivers/misc/mtk-sensorhub/Kconfig
```kconfig
# SPDX-License-Identifier: GPL-2.0-only

menuconfig MTK_SENSORHUB_PORT
	bool "MediaTek MT6853 sensors, fingerprint, NFC and haptics port"
	depends on OF && (ARCH_MEDIATEK || COMPILE_TEST)
	default n
	help
	  Small drivers that give the stock MT6853 (Redmi Note 9T) vendor
	  HALs the kernel interfaces they were written for: the AW8622 PWM
	  haptic LED-class node, the NXP PN553 /dev/nq-nci node, the
	  Goodix/FPC TEE fingerprint nodes and an SCP state probe.

	  Every driver can also be disabled from the kernel command line
	  with <driver>.enable=0.

	  If unsure, say N.

if MTK_SENSORHUB_PORT

config MTK_AW8622_VIBRATOR
	bool "Awinic AW8622 PWM haptic driver (LED class \"vibrator\")"
	depends on PWM && GPIOLIB && LEDS_CLASS
	help
	  Drives the AW8622 LRA driver through a SoC PWM output and an
	  enable GPIO. Exposes /sys/class/leds/vibrator/{activate,duration,
	  state} as used by the MediaTek vibrator HAL.

	  Disable at boot with aw8622_vibrator.enable=0.

config MTK_NQ_NCI
	bool "NXP PN553 NFC controller, qcom nq-nci compatible /dev/nq-nci"
	depends on I2C && GPIOLIB
	help
	  Character device driver for the NXP PN553 NFC controller in the
	  layout expected by the vendor NXP NCI HAL (nqx.default):
	  /dev/nq-nci with the pn544 power-control ioctls.

	  Disable at boot with mtk_nq_nci.enable=0.

config MTK_TEE_FINGERPRINT
	bool "Goodix / FPC fingerprint sensor glue for the Microtrust TEE"
	depends on SPI && INPUT && NET && PINCTRL && MICROTRUST_FP_DRIVER
	help
	  Detects the side-mounted fingerprint sensor on SPI and exposes
	  the Goodix /dev/goodix_fp interface (ioctls + netlink 29) and/or
	  the FPC fpc1022 platform sysfs attributes. The image capture
	  itself runs in the TEE. Selects the matching trusted application
	  UUID for /dev/teei_fp; when the sensor ID cannot be read from the
	  normal world both interfaces are exposed and the vendor HAL picks.

	  Disable at boot with mtk_tee_fingerprint.enable=0; force a vendor
	  with mtk_tee_fingerprint.vendor=goodix|fpc|both.

config MTK_SCP_PROBE
	bool "MT6853 SCP (sensor hub co-processor) state probe"
	help
	  Read-only diagnostics for the SCP that the bootloader starts:
	  /sys/devices/platform/10500000.scp/scp_state reports the core
	  status, program counter and the firmware region information.
	  Registers are only read when the attribute is read. This does
	  not provide sensors to Android yet.

	  Disable at boot with mtk_scp_probe.enable=0.

endif
```

## drivers/misc/mtk-vcu/Kconfig
```kconfig
# SPDX-License-Identifier: GPL-2.0-only
config MTK_VCU
	bool "MediaTek VCU bridge for the vendor video daemon"
	depends on ARCH_MEDIATEK || COMPILE_TEST
	depends on MTK_CMDQ=y
	select VIDEOBUF2_CORE
	help
	  Provides /dev/vcu, the kernel side of the MediaTek vendor video
	  stack (vpud). It relays IPI messages between video codec drivers
	  and vpud, allocates DMA working buffers for the daemon, maps the
	  codec register windows described by the "mediatek-vcu" DT node
	  and executes the daemon's GCE command lists through the mtk-cmdq
	  mailbox.

	  The driver stays inert unless the kernel is booted with
	  mtk_vcu.enable=1.

	  If unsure, say N.
```

## drivers/tee/teei/Kconfig
```kconfig
# Copyright (c) 2015-2019, MICROTRUST Incorporated
# All Rights Reserved.
#
# This program is free software; you can redistribute it and/or
# modify it under the terms of the GNU General Public License
# version 2 as published by the Free Software Foundation.
#
# This program is distributed in the hope that it will be useful,
# but WITHOUT ANY WARRANTY; without even the implied warranty of
# MERCHANTABILITY or FITNESS FOR A PARTICULAR PURPOSE. See the
# GNU General Public License for more details.

config MICROTRUST_TEE_SUPPORT
	bool "Enable Microtrust TEEI Support"
	select DMA_SHARED_BUFFER
	select GENERIC_ALLOCATOR
	depends on ARM64 && HAVE_ARM_SMCCC
	default n
	help
	  Enables the support of Microtrust TEE drivers.
	  All Microtrust related TEE drivers will depend on this option.
	  Say Y if you would like to enable this feature.
	  If unsure, say N.

config MICROTRUST_TEE_VERSION
	string "MICROTRUST TEE Version"
	depends on MICROTRUST_TEE_SUPPORT
	default "400"
	help
	  Enables the support of Microtrust new version.
	  All Microtrust related TEE drivers will depend on this option.
	  Say 400 if you would like to enable this feature.
	  If unsure, say 400.

config MICROTRUST_MTK_BOOT_SYSFS
	bool "MediaTek /sys/class/BOOT compatibility for teei_daemon"
	depends on MICROTRUST_TEE_SUPPORT && OF
	default y
	help
	  Provide /sys/class/BOOT/BOOT/boot/{boot_mode,boot_type} as created
	  by the MediaTek BSP boot driver. teei_daemon reads boot_type to
	  select the RPMB device; without it all RPMB requests from the
	  secure world fail.

config MICROTRUST_TZ_DRIVER
	bool "Microtrust TEEI Driver"
	depends on MICROTRUST_TEE_SUPPORT
	default y
	help
	  Enables the support of Microtrust trustzone linux driver.
	  This driver in charge of all initial process, creating
	  communication channels and connections with secure world.
	  Say Y if you would like to enable the driver.
	  If unsure, say Y.

config MICROTRUST_DYNAMIC_CORE
	bool "Microtrust TEEI Dynamic Core"
	depends on MICROTRUST_TEE_SUPPORT
	default y
	help
	  Enables the support of Microtrust trustzone linux driver.
	  This driver in charge of all initial process, creating
	  communication channels and connections with secure world.
	  Say Y if you would like to enable the driver.
	  If unsure, say Y.

config MICROTRUST_TZ_DRIVER_MTK_TRACING
	bool "Enable MTK tracing to profile TEEI"
	depends on MICROTRUST_TZ_DRIVER
	depends on TRACING
	default n
	help
	  Enables the support of Mediatek tracing feature in Microtrust
	  tz_driver. This feature is for tracking teei thread by MTK
	  tracing mechanism.
	  Say Y if you would like to enable this feature.

config MICROTRUST_VFS_DRIVER
	bool "Microtrust Virtual File System Driver"
	depends on MICROTRUST_TEE_SUPPORT
	default y
	help
	  Enables the support of Microtrust virtual file system driver.
	  This driver is the proxy of secure world for linux virtual
	  file system access. E.g., access for file system or RPMB.
	  Say Y if you would like to enable the driver.
	  If unsure, say Y.

config MICROTRUST_FP_DRIVER
	bool "Microtrust Fingerprint Driver"
	depends on MICROTRUST_TEE_SUPPORT
	default y
	help
	  Enables support of Microtrust fingerprint helper driver.
	  This driver provides IOCTL interface for fingerprint HAL or
	  driver to communicate with fingerpirnt trusted application.
	  Say Y if you would like to enable the helper driver.
	  If unsure, say Y.

config MICROTRUST_KEYMASTER_DRIVER
	bool "Microtrust keymaster Driver"
	depends on MICROTRUST_TEE_SUPPORT
	default y
	help
	  Enables support of Microtrust keymaster helper driver.
	  This driver provides IOCTL interface for keymaster HAL
	  to communicate with keymaster trusted application.
	  Say Y if you would like to enable the helper driver.
	  If unsure, say Y.

config MICROTRUST_DEBUG
	bool "Enable Microtrust Debug Message"
	depends on MICROTRUST_TEE_SUPPORT
	default n
	help
	  Enable debug messages output from Microtrust Linux drivers.
	  More debug information will be directed to console.
	  Say Y if you would like to enable more debug outputs.
	  If unsure, say N.

config MICROTRUST_TZ_LOG
	bool "Enable Microtrust TrustZone logger"
	depends on MICROTRUST_TEE_SUPPORT
	default n
	help
	  Enable Microtrust TrustZone logger to dump TEE logs in kernel log buffer.
	  This driver will read out log buffer and direct to console each
	  time a smc call is returned from secure world.
	  Say Y if you would like to enable secure world log support.
	  If unsure, say Y.

config MICROTRUST_TZDRIVER_DYNAMICAL_DEBUG
	bool "Microtrust tzdriver dynamical debug"
	depends on MICROTRUST_TEE_SUPPORT
	default n
	help
	  Enables support of Microtrust test driver kernel framework.
	  This framework supports DCIH and GP API test drivers.
	  Say Y if you would like to enable the test framework.
	  If unsure, say N.
```
