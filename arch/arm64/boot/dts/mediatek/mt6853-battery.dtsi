// SPDX-License-Identifier: GPL-2.0
/*
 * Battery of the Redmi Note 9T on top of mt6853.dts
 *
 * drivers/power/supply/mt6853_battery.c reads the pack voltage, the thermistor
 * and the FGADC current from the MT6359 AUXADC and keeps the MT6360 charger
 * inside the limits of the cell below. The charger node of the board overlay
 * has to be enabled for the usb and ac supplies to exist.
 */

#include <dt-bindings/iio/adc/mediatek,mt6359-auxadc.h>

/ {
	/* 5000 mAh single cell of the 4.45 V high voltage kind */
	cannong_cell: battery-cell {
		compatible = "simple-battery";
		device-chemistry = "lithium-ion";
		charge-full-design-microamp-hours = <5000000>;
		voltage-min-design-microvolt = <3400000>;
		voltage-max-design-microvolt = <4450000>;

		/* The stock firmware charges with 2 A up to 4.39 V */
		constant-charge-current-max-microamp = <2000000>;
		constant-charge-voltage-max-microvolt = <4390000>;
		charge-term-current-microamp = <200000>;

		factory-internal-resistance-micro-ohms = <107000>;
		alert-celsius = <0 60>;

		/* Percent of the factory resistance at the given degrees Celsius */
		resistance-temp-table = <50 85>, <25 100>, <10 181>, <0 305>,
					<(-10) 677>;

		/* Open circuit voltage in uV against percent, stock profile at 25 degC */
		ocv-capacity-celsius = <25>;
		ocv-capacity-table-0 = <4365000 100>, <4338500 98>, <4313500 96>, <4288700 94>,
				       <4264200 92>, <4240200 90>, <4217200 88>, <4193700 86>,
				       <4170700 84>, <4148400 82>, <4125600 80>, <4103500 78>,
				       <4083100 76>, <4067600 74>, <4048100 72>, <4015000 70>,
				       <3992200 68>, <3982000 66>, <3969200 64>, <3953700 62>,
				       <3935800 60>, <3912800 58>, <3887300 56>, <3869000 54>,
				       <3856100 52>, <3844200 49>, <3834400 47>, <3825000 45>,
				       <3817000 43>, <3809200 41>, <3802500 39>, <3796700 37>,
				       <3791200 35>, <3786100 33>, <3780300 31>, <3774600 29>,
				       <3766800 27>, <3760000 25>, <3751800 23>, <3744600 21>,
				       <3737800 19>, <3725700 17>, <3714100 15>, <3698700 13>,
				       <3691400 11>, <3690000 10>, <3688700 9>, <3687500 8>,
				       <3684700 7>, <3676300 6>, <3645300 5>, <3598600 4>,
				       <3534600 3>, <3442600 2>, <3294800 1>, <3039000 0>;
	};

	cannong_battery: battery-monitor {
		compatible = "xiaomi,cannong-battery";
		monitored-battery = <&cannong_cell>;

		io-channels = <&pmic_auxadc MT6359_AUXADC_BATADC>,
			      <&pmic_auxadc MT6359_AUXADC_BAT_TEMP>,
			      <&pmic_auxadc MT6359_AUXADC_VBIF>,
			      <&pmic_auxadc MT6359_AUXADC_IBAT>;
		io-channel-names = "vbat", "ts", "vbif", "ibat";

		/* Pull-up rail of the pack thermistor */
		vbif28-supply = <&mt_pmic_vbif28_ldo_reg>;

		/* Above 45 degC the charge voltage is lowered to 4.09 V */
		xiaomi,hot-charge-start-celsius = <45>;
		xiaomi,hot-charge-voltage-microvolt = <4090000>;
	};
};
