// SPDX-License-Identifier: GPL-2.0
/*
 * Redmi Note 9T (cannong) board overlay, decompiled from the stock dtbo
 * partition. MediaTek LK applies it to its own SoC tree at boot; the
 * built-in DTB applies it to mt6853.dtb at build time instead.
 */
/dts-v1/;
/plugin/;

/ {
	compatible = "mediatek,MT6853";

	fragment@0 {
		target = <&reserved_memory>;

		__overlay__ {
		};
	};

	fragment@1 {
		target = <&chosen>;

		__overlay__ {
			atag,videolfb-fb_base_l = "~`P";
			atag,videolfb-fb_base_h = <0x00>;
			atag,videolfb-islcmfound = <0x01>;
			atag,videolfb-islcm_inited = <0x00>;
			atag,videolfb-fps = <0x1770>;
			atag,videolfb-vramSize = <0x1be0000>;
			atag,videolfb-lcmname = "nt35595_fhd_dsi_cmd_truly_nt50358_drv";
		};
	};

	fragment@2 {
		target = <&odm>;

		__overlay__ {

			led0: led@0 {
				compatible = "mediatek,red";
				led_mode = <0x00>;
				data = <0x01>;
				pwm_config = <0x00 0x00 0x00 0x00 0x00>;
				phandle = <0x5d>;
			};

			led1: led@1 {
				compatible = "mediatek,green";
				led_mode = <0x00>;
				data = <0x01>;
				pwm_config = <0x00 0x00 0x00 0x00 0x00>;
				phandle = <0x5e>;
			};

			led2: led@2 {
				compatible = "mediatek,blue";
				led_mode = <0x00>;
				data = <0x01>;
				pwm_config = <0x00 0x00 0x00 0x00 0x00>;
				phandle = <0x5f>;
			};

			led3: led@3 {
				compatible = "mediatek,jogball-backlight";
				led_mode = <0x00>;
				data = <0x01>;
				pwm_config = <0x00 0x00 0x00 0x00 0x00>;
				phandle = <0x60>;
			};

			led4: led@4 {
				compatible = "mediatek,keyboard-backlight";
				led_mode = <0x00>;
				data = <0x01>;
				pwm_config = <0x00 0x00 0x00 0x00 0x00>;
				phandle = <0x61>;
			};

			led5: led@5 {
				compatible = "mediatek,button-backlight";
				led_mode = <0x00>;
				data = <0x01>;
				pwm_config = <0x00 0x00 0x00 0x00 0x00>;
				phandle = <0x62>;
			};

			led6: led@6 {
				compatible = "mediatek,lcd-backlight";
				led_mode = <0x04>;
				data = <0x01>;
				pwm_config = <0x00 0x01 0x00 0x00 0x00>;
				phandle = <0x63>;
			};

			vibrator0: vibrator@0 {
				compatible = "mediatek,vibrator";
				vib_timer = <0x19>;
				vib_limit = <0x09>;
				vib_vol = <0x09>;
				phandle = <0x64>;
			};

			usb_c_pinctrl: usb_c_pinctrl {
				compatible = "mediatek,usb_c_pinctrl";
				pinctrl-names = "usb_default", "redrv_c1_init", "redrv_c1_low", "redrv_c1_hiz", "redrv_c1_high", "redrv_c2_init", "redrv_c2_low", "redrv_c2_hiz", "redrv_c2_high", "switch_sel1", "switch_sel2", "switch_enable", "switch_disable";
				pinctrl-0 = <&usb_default>;
				pinctrl-1 = <&gpio_redriver_c1_init>;
				pinctrl-2 = <&gpio_redriver_c1_low>;
				pinctrl-3 = <&gpio_redriver_c1_hiz>;
				pinctrl-4 = <&gpio_redriver_c1_high>;
				pinctrl-5 = <&gpio_redriver_c2_init>;
				pinctrl-6 = <&gpio_redriver_c2_low>;
				pinctrl-7 = <&gpio_redriver_c2_hiz>;
				pinctrl-8 = <&gpio_redriver_c2_high>;
				pinctrl-9 = <&gpio_u3_switch_sel1>;
				pinctrl-10 = <&gpio_u3_switch_sel2>;
				pinctrl-11 = <&gpio_u3_switch_enable>;
				pinctrl-12 = <&gpio_u3_switch_disable>;
				status = "okay";
				phandle = <0x65>;

				usb_switch-data {
					en_pin_num = <0x00>;
					en_pin_val = <0x00>;
					sel_pin_num = <0x0b>;
					sel_pin_val = <0x01>;
					c1_pin_num = <0x29>;
					c1_pin_val = <0x02>;
					c2_pin_num = <0x28>;
					c2_pin_val = <0x01>;
				};
			};
		};
	};

	fragment@3 {
		target = <&mt6360_ldo>;

		__overlay__ {
			sdcard_det_en = <0x01>;
			sdcard_hlact = <0x00>;
		};
	};

	fragment@4 {
		target = <&mt6360_pmu>;

		__overlay__ {
			mt6360,intr_gpio_num = <0x0a>;
			mt6360,intr_gpio = <&pio>, <0x0a 0x00>;
		};
	};

	fragment@5 {
		target = <&mt6360_pmic>;

		__overlay__ {
			pwr_off_seq = <0x4000002>;
		};
	};

	fragment@6 {
		target = <&mt6360_typec>;

		__overlay__ {
			mt6360pd,intr_gpio_num = <0x09>;
			mt6360pd,intr_gpio = <&pio>, <0x09 0x00>;
			mt6360pd,pcb_gpio = <&pio>, <0x39 0x00>;
			mt6360pd,pcb_gpio_num = <0x39>;
		};
	};

	fragment@7 {
		target = <&pio>;

		__overlay__ {

			usb_default: usb_default {
				phandle = <0x01>;
			};

			gpio_redriver_c1_init: c1_init {
				phandle = <0x02>;

				pins_cmd_dat {
					pinmux = <0x2900>;
					slew-rate = <0x01>;
					output-low;
				};
			};

			gpio_redriver_c1_low: c1_low {
				phandle = <0x03>;

				pins_cmd_dat {
					pinmux = <0x2900>;
					slew-rate = <0x01>;
					output-low;
				};
			};

			gpio_redriver_c1_hiz: c1_highz {
				phandle = <0x04>;

				pins_cmd_dat {
					pinmux = <0x2900>;
					slew-rate = <0x00>;
					bias-disable;
				};
			};

			gpio_redriver_c1_high: c1_high {
				phandle = <0x05>;

				pins_cmd_dat {
					pinmux = <0x2900>;
					slew-rate = <0x01>;
					output-high;
				};
			};

			gpio_redriver_c2_init: c2_init {
				phandle = <0x06>;

				pins_cmd_dat {
					pinmux = <0x2800>;
					slew-rate = <0x01>;
					output-low;
				};
			};

			gpio_redriver_c2_low: c2_low {
				phandle = <0x07>;

				pins_cmd_dat {
					pinmux = <0x2800>;
					slew-rate = <0x01>;
					output-low;
				};
			};

			gpio_redriver_c2_hiz: c2_highz {
				phandle = <0x08>;

				pins_cmd_dat {
					pinmux = <0x2800>;
					slew-rate = <0x00>;
					bias-disable;
				};
			};

			gpio_redriver_c2_high: c2_high {
				phandle = <0x09>;

				pins_cmd_dat {
					pinmux = <0x2800>;
					slew-rate = <0x01>;
					output-high;
				};
			};

			gpio_u3_switch_sel1: u3_sw_sel1 {
				phandle = <0x0a>;

				pins_cmd_dat {
					pinmux = <0xb00>;
					slew-rate = <0x01>;
					output-low;
				};
			};

			gpio_u3_switch_sel2: u3_sw_sel2 {
				phandle = <0x0b>;

				pins_cmd_dat {
					pinmux = <0xb00>;
					slew-rate = <0x01>;
					output-high;
				};
			};

			gpio_u3_switch_enable: u3_sw_en {
				phandle = <0x0c>;
			};

			gpio_u3_switch_disable: u3_sw_dis {
				phandle = <0x0d>;
			};
		};
	};

	fragment@8 {
		target = <&pio>;

		__overlay__ {

			consys_pins_default: consys_default {
				phandle = <0x0e>;
			};

			gpslna_pins_init: gpslna@0 {
				phandle = <0x0f>;

				pins_cmd_dat {
					pinmux = <0x5700>;
					output-low;
				};
			};

			gpslna_pins_oh: gpslna@1 {
				phandle = <0x10>;

				pins_cmd_dat {
					pinmux = <0x5702>;
				};
			};

			gpslna_pins_ol: gpslna@2 {
				phandle = <0x11>;

				pins_cmd_dat {
					pinmux = <0x5700>;
					output-low;
				};
			};
		};
	};

	fragment@9 {
		target = <&consys>;

		__overlay__ {
			pinctrl-names = "default", "gps_lna_state_init", "gps_lna_state_oh", "gps_lna_state_ol";
			pinctrl-0 = <&consys_pins_default>;
			pinctrl-1 = <&gpslna_pins_init>;
			pinctrl-2 = <&gpslna_pins_oh>;
			pinctrl-3 = <&gpslna_pins_ol>;
			status = "okay";
		};
	};

	fragment@10 {
		target = <&spi1>;

		__overlay__ {
			#address-cells = <0x01>;
			#size-cells = <0x00>;

			p61@31 {
				compatible = "nxp,p61";
				reg = <0x00>;
				spi-max-frequency = <0x7a1200>;
				status = "okay";
			};
		};
	};

	fragment@11 {
		target = <&pio>;

		__overlay__ {

			nfc_default: nfc_default {
				phandle = <0x12>;
			};

			nfc_int_active: nfc_int_active {
				phandle = <0x13>;

				pins_cmd_dat {
					pinmux = <0x500>;
					slew-rate = <0x00>;
					drive-strength = <0x02>;
					bias-pull-up;
				};
			};

			nfc_int_suspend: nfc_int_suspend {
				phandle = <0x17>;

				pins_cmd_dat {
					pinmux = <0x500>;
					slew-rate = <0x00>;
					drive-strength = <0x02>;
					bias-pull-up;
				};
			};

			nfc_enable_active: nfc_enable_active {
				phandle = <0x14>;

				pins_cmd_dat {
					pinmux = <0xb00>;
					slew-rate = <0x01>;
					output-high;
					drive-strength = <0x02>;
					bias-pull-up;
				};
			};

			nfc_enable_suspend: nfc_enable_suspend {
				phandle = <0x18>;

				pins_cmd_dat {
					pinmux = <0xb00>;
					slew-rate = <0x01>;
					drive-strength = <0x02>;
					bias-disable;
				};
			};

			nfc_firmwaredownload_active: nfc_firmwaredownload_active {
				phandle = <0x16>;

				pins_cmd_dat {
					pinmux = <0x5c00>;
					slew-rate = <0x01>;
					drive-strength = <0x02>;
					bias-pull-up;
				};
			};

			nfc_firmwaredownload_suspend: nfc_firmwaredownload_suspend {
				phandle = <0x1a>;

				pins_cmd_dat {
					pinmux = <0x5c00>;
					slew-rate = <0x01>;
					drive-strength = <0x02>;
					bias-disable;
				};
			};

			nfc_clk_req_active: nfc_clk_req_active {
				phandle = <0x15>;

				pins_cmd_dat {
					pinmux = <0x5103>;
					slew-rate = <0x00>;
					input-enable;
					drive-strength = <0x02>;
					/* Retain LK's R1/R0 pull configuration. */
				};
			};

			nfc_clk_req_suspend: nfc_clk_req_suspend {
				phandle = <0x19>;

				pins_cmd_dat {
					pinmux = <0x5103>;
					slew-rate = <0x00>;
					input-enable;
					drive-strength = <0x02>;
				};
			};
		};
	};

	fragment@12 {
		target = <&i2c3>;

		__overlay__ {
			status = "okay";

			nxp@28 {
				compatible = "qcom,nq-nci";
				reg = <0x28>;
				qcom,nq-irq = <&pio>, <0x05 0x00>;
				interrupt-parent = <&pio>;
				interrupts = <0x05 0x04 0x05 0x00>;
				qcom,nq-ven = <&pio>, <0x0b 0x00>;
				qcom,nq-firm = <&pio>, <0x5c 0x00>;
				qcom,nq-clkreq = <&pio>, <0x51 0x00>;
				interrupt-names = "nfc_irq";
				pinctrl-names = "default", "nfc_active", "nfc_suspend";
				pinctrl-0 = <&nfc_default>;
				pinctrl-1 = <&nfc_int_active>, <&nfc_enable_active>, <&nfc_clk_req_active>, <&nfc_firmwaredownload_active>;
				pinctrl-2 = <&nfc_int_suspend>, <&nfc_enable_suspend>, <&nfc_clk_req_suspend>, <&nfc_firmwaredownload_suspend>;
			};
		};
	};

	fragment@13 {
		target = <&spi5>;

		__overlay__ {
			status = "okay";
			#address-cells = <0x01>;
			#size-cells = <0x00>;

			fingerprint@0 {
				compatible = "goodix,goodix-fp";
				reg = <0x00>;
				spi-max-frequency = <0x7a1200>;
				netlink-event = <0x1e>;
				status = "okay";
			};
		};
	};

	fragment@14 {
		target = <&goodix_fp>;

		__overlay__ {
			pinctrl-names = "default", "reset_high", "reset_low";
			pinctrl-0 = <&fingerprint_default>;
			pinctrl-1 = <&fingerprint_reset_high>;
			pinctrl-2 = <&fingerprint_reset_low>;
			fpc,gpio_irq = <&pio>, <0x30 0x00>;
			interrupt-parent = <&pio>;
			interrupts = <0x30 0x01 0x30 0x00>;
			status = "okay";
		};
	};

	fragment@15 {
		target = <&pio>;

		__overlay__ {

			fingerprint_default: state_default {
				phandle = <0x1b>;

				pins_cmd_dat {
					pinmux = <0x3000>;
					slew-rate = <0x00>;
					bias-disable;
				};
			};

			fingerprint_reset_high: state_reset_high {
				phandle = <0x1c>;

				pins_cmd_dat {
					pinmux = <0x2f00>;
					slew-rate = <0x01>;
					output-high;
				};
			};

			fingerprint_reset_low: state_reset_low {
				phandle = <0x1d>;

				pins_cmd_dat {
					pinmux = <0x2f00>;
					slew-rate = <0x01>;
					output-low;
				};
			};

			test_mode_irq: test_mode_irq {
				phandle = <0x5c>;

				pins_cmd_dat {
					pinmux = <0x2100>;
					drive-strength = <0x02>;
					bias-pull-up;
					input-enable;
				};
			};
		};
	};

	fragment@16 {
		target = <&spi4>;

		__overlay__ {
			status = "okay";
			#address-cells = <0x01>;
			#size-cells = <0x00>;

			touch_spi@0 {
				compatible = "xiaomi,spi-for-tp";
				reg = <0x00>;
				status = "ok";
				spi-max-frequency = <0x5b8d80>;
			};
		};
	};

	fragment@17 {
		target = <&touch>;

		__overlay__ {
			tpd-resolution = <0x438 0x924>;
			use-tpd-button = <0x00>;
			tpd-key-num = <0x03>;
			tpd-key-local = <0x8b 0xac 0x9e 0x00>;
			tpd-key-dim-local = <0x5a 0x373 0x64 0x28 0xe6 0x373 0x64 0x28 0x172 0x373 0x64 0x28 0x00 0x00 0x00 0x00>;
			tpd-max-touch-num = <0x0a>;
			tpd-filter-enable = <0x00>;
			tpd-filter-pixel-density = <0xa8>;
			tpd-filter-custom-prameters = <0x00 0x00 0x00 0x00 0x00 0x00 0x00 0x00 0x00 0x00 0x00 0x00>;
			tpd-filter-custom-speed = <0x00 0x00 0x00>;
			pinctrl-names = "default", "state_eint_as_int", "state_eint_output0", "state_eint_output1", "state_rst_output0", "state_rst_output1";
			pinctrl-0 = <&ctp_pins_default>;
			pinctrl-1 = <&ctp_pins_eint_as_int>;
			pinctrl-2 = <&ctp_pins_eint_output0>;
			pinctrl-3 = <&ctp_pins_eint_output1>;
			pinctrl-4 = <&ctp_pins_rst_output0>;
			pinctrl-5 = <&ctp_pins_rst_output1>;
			status = "okay";
		};
	};

	fragment@18 {
		target = <&pio>;

		__overlay__ {

			ctp_pins_default: eint0default {
				phandle = <0x1e>;
			};

			ctp_pins_eint_as_int: ent@0 {
				phandle = <0x1f>;

				pins_cmd_dat {
					pinmux = <0xe00>;
					slew-rate = <0x00>;
					bias-disable;
				};
			};

			ctp_pins_eint_output0: eintoutput0 {
				phandle = <0x20>;

				pins_cmd_dat {
					pinmux = <0xe00>;
					slew-rate = <0x01>;
					output-low;
				};
			};

			ctp_pins_eint_output1: eintoutput1 {
				phandle = <0x21>;

				pins_cmd_dat {
					pinmux = <0xe00>;
					slew-rate = <0x01>;
					output-high;
				};
			};

			ctp_pins_rst_output0: rstoutput0 {
				phandle = <0x22>;

				pins_cmd_dat {
					pinmux = <0xf00>;
					slew-rate = <0x01>;
					output-low;
				};
			};

			ctp_pins_rst_output1: rstoutput1 {
				phandle = <0x23>;

				pins_cmd_dat {
					pinmux = <0xf00>;
					slew-rate = <0x01>;
					output-high;
				};
			};

			ctp_gt9896s_pins_default: pins_default {
				phandle = <0x66>;
			};

			ctp_ts_int_active: int_active {
				phandle = <0x67>;

				pins_cmd_dat {
					pinmux = <0xe00>;
					slew-rate = <0x00>;
					bias-pull-up = <0x0b>;
				};
			};

			ctp_ts_reset_active: reset_active {
				phandle = <0x68>;

				pins_cmd_dat {
					pinmux = <0xf00>;
					slew-rate = <0x01>;
					output-high;
				};
			};

			ctp_ts_int_suspend: int_suspend {
				phandle = <0x69>;

				pins_cmd_dat {
					pinmux = <0xe00>;
					slew-rate = <0x01>;
					output-low;
				};
			};

			ctp_ts_reset_suspend: reset_suspend {
				phandle = <0x6a>;

				pins_cmd_dat {
					pinmux = <0xf00>;
					slew-rate = <0x01>;
					output-low;
				};
			};

			ctp_ts_i2c_mode: i2cmode_default {
				phandle = <0x6b>;

				pins_cmd_dat {
					pinmux = <0x6101 0x6201>;
				};
			};
		};
	};

	fragment@19 {
		target = <&pio>;

		__overlay__ {

			camera_pins_cam0_rst_0: cam0@0 {
				phandle = <0x25>;

				pins_cmd_dat {
					pinmux = <0x3600>;
					slew-rate = <0x01>;
					output-low;
				};
			};

			camera_pins_cam0_rst_1: cam0@1 {
				phandle = <0x26>;

				pins_cmd_dat {
					pinmux = <0x3600>;
					slew-rate = <0x01>;
					output-high;
				};
			};

			camera_pins_cam0_pnd_0: cam0@2 {
				phandle = <0x27>;

				pins_cmd_dat {
					pinmux = <0x3700>;
					slew-rate = <0x01>;
					output-low;
				};
			};

			camera_pins_cam0_pnd_1: cam0@3 {
				phandle = <0x28>;

				pins_cmd_dat {
					pinmux = <0x3700>;
					slew-rate = <0x01>;
					output-high;
				};
			};

			camera_pins_cam1_rst_0: cam1@0 {
				phandle = <0x29>;

				pins_cmd_dat {
					pinmux = <0x3c00>;
					slew-rate = <0x01>;
					output-low;
				};
			};

			camera_pins_cam1_rst_1: cam1@1 {
				phandle = <0x2a>;

				pins_cmd_dat {
					pinmux = <0x3c00>;
					slew-rate = <0x01>;
					output-high;
				};
			};

			camera_pins_cam1_pnd_0: cam1@2 {
				phandle = <0x2b>;

				pins_cmd_dat {
					pinmux = <0x3c00>;
					slew-rate = <0x01>;
					output-low;
				};
			};

			camera_pins_cam1_pnd_1: cam1@3 {
				phandle = <0x2c>;

				pins_cmd_dat {
					pinmux = <0x3c00>;
					slew-rate = <0x01>;
					output-high;
				};
			};

			camera_pins_cam2_rst_0: cam2@0 {
				phandle = <0x2d>;

				pins_cmd_dat {
					pinmux = <0x3800>;
					slew-rate = <0x01>;
					output-low;
				};
			};

			camera_pins_cam2_rst_1: cam2@1 {
				phandle = <0x2e>;

				pins_cmd_dat {
					pinmux = <0x3800>;
					slew-rate = <0x01>;
					output-high;
				};
			};

			camera_pins_cam2_pnd_0: cam2@2 {
				phandle = <0x2f>;

				pins_cmd_dat {
					pinmux = <0x3800>;
					slew-rate = <0x01>;
					output-low;
				};
			};

			camera_pins_cam2_pnd_1: cam2@3 {
				phandle = <0x30>;

				pins_cmd_dat {
					pinmux = <0x3800>;
					slew-rate = <0x01>;
					output-high;
				};
			};

			camera_pins_cam2_vcamd_0: cam2@4 {
				phandle = <0x4b>;

				pins_cmd_dat {
					pinmux = <0x5200>;
					slew-rate = <0x01>;
					output-low;
				};
			};

			camera_pins_cam2_vcamd_1: cam2@5 {
				phandle = <0x4c>;

				pins_cmd_dat {
					pinmux = <0x5200>;
					slew-rate = <0x01>;
					output-high;
				};
			};

			camera_pins_cam3_rst_0: cam3@0 {
				phandle = <0x31>;

				pins_cmd_dat {
					pinmux = <0x3a00>;
					slew-rate = <0x01>;
					output-low;
				};
			};

			camera_pins_cam3_rst_1: cam3@1 {
				phandle = <0x32>;

				pins_cmd_dat {
					pinmux = <0x3a00>;
					slew-rate = <0x01>;
					output-high;
				};
			};

			camera_pins_cam3_pnd_0: cam3@2 {
				phandle = <0x33>;

				pins_cmd_dat {
					pinmux = <0x3a00>;
					slew-rate = <0x01>;
					output-low;
				};
			};

			camera_pins_cam3_pnd_1: cam3@3 {
				phandle = <0x34>;

				pins_cmd_dat {
					pinmux = <0x3a00>;
					slew-rate = <0x01>;
					output-high;
				};
			};

			camera_pins_cam3_vcamd_0: cam3@4 {
				phandle = <0x35>;

				pins_cmd_dat {
					pinmux = <0x5200>;
					slew-rate = <0x01>;
					output-low;
				};
			};

			camera_pins_cam3_vcamd_1: cam3@5 {
				phandle = <0x36>;

				pins_cmd_dat {
					pinmux = <0x5200>;
					slew-rate = <0x01>;
					output-high;
				};
			};

			camera_pins_cam0_mclk_off: camera_pins_cam0_mclk_off {
				phandle = <0x37>;

				pins_cmd_dat {
					pinmux = <0x3400>;
					drive-strength = <4>;
				};
			};

			camera_pins_cam0_mclk_2ma: camera_pins_cam0_mclk_2ma {
				phandle = <0x38>;

				pins_cmd_dat {
					pinmux = <0x3401>;
					drive-strength = <2>;
				};
			};

			camera_pins_cam0_mclk_4ma: camera_pins_cam0_mclk_4ma {
				phandle = <0x39>;

				pins_cmd_dat {
					pinmux = <0x3401>;
					drive-strength = <4>;
				};
			};

			camera_pins_cam0_mclk_6ma: camera_pins_cam0_mclk_6ma {
				phandle = <0x3a>;

				pins_cmd_dat {
					pinmux = <0x3401>;
					drive-strength = <6>;
				};
			};

			camera_pins_cam0_mclk_8ma: camera_pins_cam0_mclk_8ma {
				phandle = <0x3b>;

				pins_cmd_dat {
					pinmux = <0x3401>;
					drive-strength = <8>;
				};
			};

			camera_pins_cam1_mclk_off: camera_pins_cam1_mclk_off {
				phandle = <0x3c>;

				pins_cmd_dat {
					pinmux = <0x3200>;
					drive-strength = <4>;
				};
			};

			camera_pins_cam1_mclk_2ma: camera_pins_cam1_mclk_2ma {
				phandle = <0x3d>;

				pins_cmd_dat {
					pinmux = <0x3201>;
					drive-strength = <2>;
				};
			};

			camera_pins_cam1_mclk_4ma: camera_pins_cam1_mclk_4ma {
				phandle = <0x3e>;

				pins_cmd_dat {
					pinmux = <0x3201>;
					drive-strength = <4>;
				};
			};

			camera_pins_cam1_mclk_6ma: camera_pins_cam1_mclk_6ma {
				phandle = <0x3f>;

				pins_cmd_dat {
					pinmux = <0x3201>;
					drive-strength = <6>;
				};
			};

			camera_pins_cam1_mclk_8ma: camera_pins_cam1_mclk_8ma {
				phandle = <0x40>;

				pins_cmd_dat {
					pinmux = <0x3201>;
					drive-strength = <8>;
				};
			};

			camera_pins_cam2_mclk_off: camera_pins_cam2_mclk_off {
				phandle = <0x41>;

				pins_cmd_dat {
					pinmux = <0x3300>;
					drive-strength = <4>;
				};
			};

			camera_pins_cam2_mclk_2ma: camera_pins_cam2_mclk_2ma {
				phandle = <0x42>;

				pins_cmd_dat {
					pinmux = <0x3301>;
					drive-strength = <2>;
				};
			};

			camera_pins_cam2_mclk_4ma: camera_pins_cam2_mclk_4ma {
				phandle = <0x43>;

				pins_cmd_dat {
					pinmux = <0x3301>;
					drive-strength = <4>;
				};
			};

			camera_pins_cam2_mclk_6ma: camera_pins_cam2_mclk_6ma {
				phandle = <0x44>;

				pins_cmd_dat {
					pinmux = <0x3301>;
					drive-strength = <6>;
				};
			};

			camera_pins_cam2_mclk_8ma: camera_pins_cam2_mclk_8ma {
				phandle = <0x45>;

				pins_cmd_dat {
					pinmux = <0x3301>;
					drive-strength = <8>;
				};
			};

			camera_pins_cam3_mclk_off: camera_pins_cam3_mclk_off {
				phandle = <0x46>;

				pins_cmd_dat {
					pinmux = <0x3100>;
					drive-strength = <4>;
				};
			};

			camera_pins_cam3_mclk_2ma: camera_pins_cam3_mclk_2ma {
				phandle = <0x47>;

				pins_cmd_dat {
					pinmux = <0x3101>;
					drive-strength = <2>;
				};
			};

			camera_pins_cam3_mclk_4ma: camera_pins_cam3_mclk_4ma {
				phandle = <0x48>;

				pins_cmd_dat {
					pinmux = <0x3101>;
					drive-strength = <4>;
				};
			};

			camera_pins_cam3_mclk_6ma: camera_pins_cam3_mclk_6ma {
				phandle = <0x49>;

				pins_cmd_dat {
					pinmux = <0x3101>;
					drive-strength = <6>;
				};
			};

			camera_pins_cam3_mclk_8ma: camera_pins_cam3_mclk_8ma {
				phandle = <0x4a>;

				pins_cmd_dat {
					pinmux = <0x3101>;
					drive-strength = <8>;
				};
			};

			camera_pins_default: camdefault {
				phandle = <0x24>;
			};
		};
	};

	fragment@20 {
		target = <&kd_camera_hw1>;

		__overlay__ {
			pinctrl-names = "default", "cam0_rst0", "cam0_rst1", "cam0_pnd0", "cam0_pnd1", "cam1_rst0", "cam1_rst1", "cam1_pnd0", "cam1_pnd1", "cam2_rst0", "cam2_rst1", "cam2_pnd0", "cam2_pnd1", "cam3_rst0", "cam3_rst1", "cam3_pnd0", "cam3_pnd1", "cam3_ldo_vcamd_0", "cam3_ldo_vcamd_1", "cam0_mclk_off", "cam0_mclk_2mA", "cam0_mclk_4mA", "cam0_mclk_6mA", "cam0_mclk_8mA", "cam1_mclk_off", "cam1_mclk_2mA", "cam1_mclk_4mA", "cam1_mclk_6mA", "cam1_mclk_8mA", "cam2_mclk_off", "cam2_mclk_2mA", "cam2_mclk_4mA", "cam2_mclk_6mA", "cam2_mclk_8mA", "cam3_mclk_off", "cam3_mclk_2mA", "cam3_mclk_4mA", "cam3_mclk_6mA", "cam3_mclk_8mA", "cam2_ldo_vcamd_0", "cam2_ldo_vcamd_1";
			pinctrl-0 = <&camera_pins_default>;
			pinctrl-1 = <&camera_pins_cam0_rst_0>;
			pinctrl-2 = <&camera_pins_cam0_rst_1>;
			pinctrl-3 = <&camera_pins_cam0_pnd_0>;
			pinctrl-4 = <&camera_pins_cam0_pnd_1>;
			pinctrl-5 = <&camera_pins_cam1_rst_0>;
			pinctrl-6 = <&camera_pins_cam1_rst_1>;
			pinctrl-7 = <&camera_pins_cam1_pnd_0>;
			pinctrl-8 = <&camera_pins_cam1_pnd_1>;
			pinctrl-9 = <&camera_pins_cam2_rst_0>;
			pinctrl-10 = <&camera_pins_cam2_rst_1>;
			pinctrl-11 = <&camera_pins_cam2_pnd_0>;
			pinctrl-12 = <&camera_pins_cam2_pnd_1>;
			pinctrl-13 = <&camera_pins_cam3_rst_0>;
			pinctrl-14 = <&camera_pins_cam3_rst_1>;
			pinctrl-15 = <&camera_pins_cam3_pnd_0>;
			pinctrl-16 = <&camera_pins_cam3_pnd_1>;
			pinctrl-17 = <&camera_pins_cam3_vcamd_0>;
			pinctrl-18 = <&camera_pins_cam3_vcamd_1>;
			pinctrl-19 = <&camera_pins_cam0_mclk_off>;
			pinctrl-20 = <&camera_pins_cam0_mclk_2ma>;
			pinctrl-21 = <&camera_pins_cam0_mclk_4ma>;
			pinctrl-22 = <&camera_pins_cam0_mclk_6ma>;
			pinctrl-23 = <&camera_pins_cam0_mclk_8ma>;
			pinctrl-24 = <&camera_pins_cam1_mclk_off>;
			pinctrl-25 = <&camera_pins_cam1_mclk_2ma>;
			pinctrl-26 = <&camera_pins_cam1_mclk_4ma>;
			pinctrl-27 = <&camera_pins_cam1_mclk_6ma>;
			pinctrl-28 = <&camera_pins_cam1_mclk_8ma>;
			pinctrl-29 = <&camera_pins_cam2_mclk_off>;
			pinctrl-30 = <&camera_pins_cam2_mclk_2ma>;
			pinctrl-31 = <&camera_pins_cam2_mclk_4ma>;
			pinctrl-32 = <&camera_pins_cam2_mclk_6ma>;
			pinctrl-33 = <&camera_pins_cam2_mclk_8ma>;
			pinctrl-34 = <&camera_pins_cam3_mclk_off>;
			pinctrl-35 = <&camera_pins_cam3_mclk_2ma>;
			pinctrl-36 = <&camera_pins_cam3_mclk_4ma>;
			pinctrl-37 = <&camera_pins_cam3_mclk_6ma>;
			pinctrl-38 = <&camera_pins_cam3_mclk_8ma>;
			pinctrl-39 = <&camera_pins_cam2_vcamd_0>;
			pinctrl-40 = <&camera_pins_cam2_vcamd_1>;
			cam0_vcama-supply = <&fan53870_l3>;
			cam0_vcamd-supply = <&fan53870_l2>;
			cam0_vcamio-supply = <&mt_pmic_vcamio_ldo_reg>;
			cam0_vcamaf-supply = <&fan53870_l7>;
			cam1_vcama-supply = <&fan53870_l5>;
			cam1_vcamd-supply = <&fan53870_l1>;
			cam1_vcamio-supply = <&mt_pmic_vcamio_ldo_reg>;
			cam2_vcama-supply = <&fan53870_l6>;
			cam2_vcamio-supply = <&mt_pmic_vcamio_ldo_reg>;
			cam3_vcama-supply = <&fan53870_l4>;
			cam3_vcamio-supply = <&mt_pmic_vcamio_ldo_reg>;
			cam0_vcamap-supply = <&PM8008_L3P>;
			cam0_vcamdp-supply = <&PM8008_L2P>;
			cam0_vcamiop-supply = <&mt_pmic_vcamio_ldo_reg>;
			cam0_vcamafp-supply = <&PM8008_L7P>;
			cam1_vcamap-supply = <&PM8008_L5P>;
			cam1_vcamdp-supply = <&PM8008_L1P>;
			cam1_vcamiop-supply = <&mt_pmic_vcamio_ldo_reg>;
			cam2_vcamap-supply = <&PM8008_L6P>;
			cam2_vcamiop-supply = <&mt_pmic_vcamio_ldo_reg>;
			cam3_vcamap-supply = <&PM8008_L4P>;
			cam3_vcamiop-supply = <&mt_pmic_vcamio_ldo_reg>;
			cam0_enable_sensor = "s5kgm1stofilm_mipi_raw";
			cam1_enable_sensor = "s5k3l6ofilm_mipi_raw";
			cam2_enable_sensor = "ov02b10ofilm_mipi_raw ov8856ofilm_mipi_raw";
			cam3_enable_sensor = "hi259ofilm_mipi_raw";
			status = "okay";
		};
	};

	fragment@21 {
		target = <&i2c2>;

		__overlay__ {

			mtk_camera_eeprom0: camera_eeprom0@50 {
				compatible = "mediatek,camera_eeprom";
				reg = <0x50>;
				status = "okay";
				phandle = <0x6c>;
			};
		};
	};

	fragment@22 {
		target = <&i2c4>;

		__overlay__ {

			mtk_camera_eeprom1: camera_eeprom1@51 {
				compatible = "mediatek,camera_eeprom";
				reg = <0x51>;
				status = "okay";
				phandle = <0x6d>;
			};
		};
	};

	fragment@23 {
		target = <&i2c8>;

		__overlay__ {

			mtk_camera_eeprom2: camera_eeprom2@50 {
				compatible = "mediatek,camera_eeprom";
				reg = <0x50>;
				status = "okay";
				phandle = <0x6e>;
			};
		};
	};

	fragment@24 {
		target = <&i2c8>;

		__overlay__ {

			mtk_camera_eeprom3: camera_eeprom3@51 {
				compatible = "mediatek,camera_eeprom";
				reg = <0x51>;
				status = "okay";
				phandle = <0x6f>;
			};
		};
	};

	fragment@25 {
		target = <&auxadc>;

		__overlay__ {

			adc_channel@ {
				compatible = "mediatek,adc_channel";
				mediatek,temperature0 = <0x00>;
				mediatek,temperature1 = <0x01>;
				mediatek,adc_fdd_rf_params_dynamic_custom_ch = <0x02>;
				status = "okay";
			};
		};
	};

	fragment@26 {
		target = <&md_auxadc>;

		__overlay__ {
			io-channels = <&auxadc>, <0x02>;
		};
	};

	fragment@27 {
		target = <&pmic_clock_buffer_ctrl>;

		__overlay__ {
			mediatek,clkbuf-quantity = <0x07>;
			mediatek,clkbuf-config = <0x02 0x01 0x01 0x02 0x00 0x00 0x01>;
			mediatek,clkbuf-output-impedance = <0x06 0x04 0x04 0x04 0x00 0x00 0x04>;
			mediatek,clkbuf-controls-for-desense = <0x00 0x04 0x00 0x04 0x00 0x00 0x00>;
			status = "okay";
		};
	};

	fragment@28 {
		target = <&i2c0>;

		__overlay__ {
			#address-cells = <0x01>;
			#size-cells = <0x00>;
			clock-frequency = <0x61a80>;
			mediatek,use-open-drain;
		};
	};

	fragment@29 {
		target = <&i2c1>;

		__overlay__ {
			#address-cells = <0x01>;
			#size-cells = <0x00>;
			clock-frequency = <0x61a80>;
			mediatek,use-open-drain;
		};
	};

	fragment@30 {
		target = <&i2c2>;

		__overlay__ {
			#address-cells = <0x01>;
			#size-cells = <0x00>;
			clock-frequency = <0x61a80>;
			mediatek,use-open-drain;

			camera_main_af_mtk: camera_main_af@18 {
				compatible = "mediatek,camera_main_af";
				reg = <0x18>;
				status = "okay";
				phandle = <0x70>;
			};

			camera_main_mtk: camera_main@20 {
				compatible = "mediatek,camera_main";
				reg = <0x20>;
				status = "okay";
				phandle = <0x71>;
			};
		};
	};

	fragment@31 {
		target = <&i2c3>;

		__overlay__ {
			#address-cells = <0x01>;
			#size-cells = <0x00>;
			clock-frequency = <0x61a80>;
			mediatek,use-open-drain;

			nfc_mtk: nfc@08 {
				compatible = "mediatek,nfc";
				reg = <0x08>;
				status = "okay";
				phandle = <0x72>;
			};
		};
	};

	fragment@32 {
		target = <&i2c4>;

		__overlay__ {
			#address-cells = <0x01>;
			#size-cells = <0x00>;
			clock-frequency = <0x61a80>;
			mediatek,use-open-drain;

			camera_sub_mtk: camera_sub@5a {
				compatible = "mediatek,camera_sub";
				reg = <0x5a>;
				status = "okay";
				phandle = <0x73>;
			};
		};
	};

	fragment@33 {
		target = <&i2c5>;

		__overlay__ {
			#address-cells = <0x01>;
			#size-cells = <0x00>;
			clock-frequency = <0x33e140>;
			mediatek,use-push-pull;

			subpmic_mtk: subpmic@34 {
				compatible = "mediatek,subpmic";
				reg = <0x34>;
				status = "okay";
				phandle = <0x74>;
			};

			usb_type_c_mtk: usb_type_c@4e {
				compatible = "mediatek,usb_type_c";
				reg = <0x4e>;
				status = "okay";
				phandle = <0x75>;
			};

			subpmic_pmic_mtk: subpmic_pmic@1a {
				compatible = "mediatek,subpmic_pmic";
				reg = <0x1a>;
				status = "okay";
				phandle = <0x76>;
			};

			subpmic_ldo_mtk: subpmic_ldo@64 {
				compatible = "mediatek,subpmic_ldo";
				reg = <0x64>;
				status = "okay";
				phandle = <0x77>;
			};
		};
	};

	fragment@34 {
		target = <&i2c6>;

		__overlay__ {
			#address-cells = <0x01>;
			#size-cells = <0x00>;
			clock-frequency = <0x61a80>;
			mediatek,use-open-drain;
		};
	};

	fragment@35 {
		target = <&i2c7>;

		__overlay__ {
			#address-cells = <0x01>;
			#size-cells = <0x00>;
			clock-frequency = <0x61a80>;
			mediatek,use-open-drain;

			i2c_lcd_bias_mtk: i2c_lcd_bias@11 {
				compatible = "mediatek,i2c_lcd_bias";
				reg = <0x11>;
				status = "disabled";
				phandle = <0x78>;
			};
		};
	};

	fragment@36 {
		target = <&i2c8>;

		__overlay__ {
			#address-cells = <0x01>;
			#size-cells = <0x00>;
			clock-frequency = <0x61a80>;
			mediatek,use-open-drain;

			camera_sub_two_mtk: camera_sub_two@60 {
				compatible = "mediatek,camera_sub_two";
				reg = <0x60>;
				status = "okay";
				phandle = <0x79>;
			};

			camera_main_two_mtk: camera_main_two@6c {
				compatible = "mediatek,camera_main_two";
				reg = <0x6c>;
				status = "okay";
				phandle = <0x7a>;
			};
		};
	};

	fragment@37 {
		target = <&i2c9>;

		__overlay__ {
			#address-cells = <0x01>;
			#size-cells = <0x00>;
			clock-frequency = <0x61a80>;
			mediatek,use-open-drain;
		};
	};

	fragment@38 {
		target = <&gpio_usage_mapping>;

		__overlay__ {
			GPIO_FDD_BAND_SUPPORT_DETECT_1ST_PIN = <&pio>, <0x25 0x00>;
			GPIO_FDD_BAND_SUPPORT_DETECT_2ND_PIN = <&pio>, <0x26 0x00>;
			GPIO_FDD_BAND_SUPPORT_DETECT_3RD_PIN = <&pio>, <0x27 0x00>;
			GPIO_SIM1_HOT_PLUG = <&pio>, <0x4d 0x00>;
			GPIO_SIM2_SCLK = <&pio>, <0x77 0x00>;
			GPIO_SIM2_SRST = <&pio>, <0x78 0x00>;
			GPIO_SIM2_SIO = <&pio>, <0x79 0x00>;
			GPIO_SIM1_SIO = <&pio>, <0x7a 0x00>;
			GPIO_SIM1_SRST = <&pio>, <0x7b 0x00>;
			GPIO_SIM1_SCLK = <&pio>, <0x7c 0x00>;
			GPIO_RF_PWREN_RST_PIN = <&pio>, <0xa9 0x00>;
		};
	};

	fragment@39 {
		target = <&gpio>;

		__overlay__ {
			gpio_init_default = <0x00 0x00 0x00 0x00 0x01 0x00 0x01 0x01 0x00 0x00 0x00 0x01 0x01 0x01 0x02 0x00 0x00 0x00 0x01 0x01 0x01 0x03 0x00 0x00 0x00 0x01 0x00 0x01 0x04 0x00 0x00 0x00 0x01 0x01 0x01 0x05 0x00 0x00 0x00 0x01 0x00 0x00 0x06 0x00 0x01 0x00 0x01 0x00 0x01 0x07 0x00 0x01 0x00 0x01 0x00 0x01 0x08 0x07 0x00 0x00 0x01 0x00 0x01 0x09 0x00 0x00 0x00 0x01 0x01 0x01 0x0a 0x00 0x00 0x00 0x01 0x01 0x01 0x0b 0x00 0x01 0x00 0x01 0x01 0x00 0x0c 0x02 0x00 0x00 0x00 0x00 0x01 0x0d 0x02 0x00 0x00 0x00 0x00 0x01 0x0e 0x00 0x00 0x00 0x01 0x01 0x01 0x0f 0x00 0x01 0x01 0x00 0x00 0x01 0x10 0x07 0x00 0x00 0x01 0x00 0x01 0x11 0x07 0x00 0x00 0x01 0x00 0x01 0x12 0x07 0x00 0x00 0x01 0x00 0x01 0x13 0x07 0x00 0x00 0x01 0x00 0x01 0x14 0x01 0x01 0x00 0x00 0x00 0x00 0x15 0x01 0x01 0x01 0x00 0x00 0x00 0x16 0x01 0x01 0x00 0x00 0x00 0x00 0x17 0x01 0x00 0x00 0x01 0x00 0x00 0x18 0x02 0x00 0x00 0x00 0x00 0x01 0x19 0x02 0x00 0x00 0x00 0x00 0x01 0x1a 0x02 0x00 0x00 0x00 0x00 0x01 0x1b 0x02 0x00 0x00 0x01 0x00 0x01 0x1c 0x01 0x00 0x00 0x01 0x00 0x01 0x1d 0x01 0x00 0x00 0x00 0x00 0x01 0x1e 0x01 0x00 0x00 0x00 0x00 0x01 0x1f 0x01 0x00 0x00 0x01 0x01 0x01 0x20 0x00 0x00 0x00 0x00 0x00 0x00 0x21 0x01 0x00 0x00 0x00 0x00 0x01 0x22 0x01 0x00 0x00 0x00 0x00 0x01 0x23 0x01 0x00 0x00 0x01 0x00 0x01 0x24 0x01 0x00 0x00 0x00 0x00 0x01 0x25 0x00 0x00 0x00 0x01 0x00 0x01 0x26 0x00 0x00 0x00 0x01 0x00 0x01 0x27 0x00 0x00 0x00 0x01 0x00 0x01 0x28 0x00 0x01 0x00 0x01 0x00 0x01 0x29 0x00 0x01 0x00 0x01 0x00 0x01 0x2a 0x07 0x00 0x00 0x01 0x00 0x01 0x2b 0x07 0x00 0x00 0x01 0x00 0x01 0x2c 0x07 0x00 0x00 0x01 0x00 0x01 0x2d 0x07 0x00 0x00 0x00 0x00 0x01 0x2e 0x07 0x00 0x00 0x01 0x00 0x01 0x2f 0x00 0x01 0x01 0x00 0x00 0x01 0x30 0x00 0x00 0x00 0x01 0x00 0x01 0x31 0x00 0x01 0x00 0x01 0x00 0x01 0x32 0x00 0x01 0x00 0x01 0x00 0x01 0x33 0x00 0x01 0x00 0x01 0x00 0x01 0x34 0x00 0x01 0x00 0x01 0x00 0x01 0x35 0x00 0x01 0x00 0x01 0x00 0x01 0x36 0x00 0x01 0x00 0x01 0x00 0x01 0x37 0x00 0x01 0x00 0x01 0x00 0x01 0x38 0x00 0x01 0x00 0x01 0x00 0x01 0x39 0x00 0x01 0x01 0x01 0x00 0x01 0x3a 0x00 0x01 0x00 0x01 0x00 0x01 0x3b 0x01 0x00 0x00 0x01 0x00 0x01 0x3c 0x00 0x01 0x00 0x01 0x00 0x01 0x3d 0x01 0x00 0x00 0x01 0x01 0x01 0x3e 0x01 0x00 0x00 0x00 0x00 0x01 0x3f 0x01 0x00 0x00 0x01 0x01 0x01 0x40 0x01 0x00 0x00 0x00 0x00 0x01 0x4d 0x01 0x00 0x00 0x01 0x01 0x01 0x4e 0x00 0x00 0x00 0x00 0x00 0x01 0x4f 0x01 0x00 0x00 0x01 0x01 0x00 0x50 0x01 0x00 0x00 0x01 0x01 0x00 0x51 0x03 0x00 0x00 0x01 0x00 0x01 0x52 0x00 0x01 0x01 0x01 0x00 0x01 0x53 0x01 0x00 0x00 0x00 0x00 0x01 0x54 0x01 0x00 0x00 0x01 0x00 0x01 0x55 0x01 0x00 0x00 0x00 0x00 0x01 0x56 0x00 0x01 0x00 0x00 0x00 0x01 0x57 0x02 0x00 0x00 0x01 0x00 0x01 0x58 0x00 0x00 0x00 0x01 0x00 0x01 0x59 0x00 0x01 0x00 0x00 0x00 0x00 0x5a 0x01 0x00 0x00 0x00 0x00 0x01 0x5b 0x00 0x00 0x00 0x01 0x00 0x01 0x5c 0x00 0x01 0x00 0x01 0x00 0x00 0x5d 0x00 0x01 0x00 0x01 0x00 0x01 0x5e 0x00 0x01 0x00 0x01 0x00 0x01 0x5f 0x01 0x00 0x00 0x01 0x00 0x01 0x60 0x01 0x00 0x00 0x01 0x00 0x01 0x61 0x02 0x00 0x00 0x00 0x00 0x01 0x62 0x02 0x00 0x00 0x00 0x00 0x01 0x63 0x02 0x00 0x00 0x01 0x01 0x01 0x64 0x02 0x00 0x00 0x01 0x01 0x01 0x65 0x01 0x00 0x00 0x01 0x01 0x01 0x66 0x01 0x00 0x00 0x01 0x01 0x01 0x67 0x01 0x00 0x00 0x01 0x01 0x01 0x68 0x01 0x00 0x00 0x01 0x01 0x01 0x69 0x01 0x00 0x00 0x01 0x01 0x01 0x6a 0x01 0x00 0x00 0x01 0x01 0x01 0x6b 0x01 0x00 0x00 0x01 0x01 0x01 0x6c 0x01 0x00 0x00 0x01 0x01 0x01 0x6d 0x01 0x00 0x00 0x01 0x01 0x01 0x6e 0x01 0x00 0x00 0x01 0x01 0x01 0x6f 0x01 0x00 0x00 0x01 0x01 0x01 0x70 0x01 0x00 0x00 0x01 0x01 0x01 0x71 0x01 0x00 0x00 0x01 0x01 0x01 0x72 0x01 0x00 0x00 0x01 0x01 0x01 0x73 0x01 0x00 0x00 0x00 0x00 0x01 0x74 0x01 0x00 0x00 0x00 0x00 0x01 0x75 0x01 0x00 0x00 0x00 0x00 0x01 0x76 0x01 0x00 0x00 0x00 0x00 0x01 0x77 0x01 0x00 0x00 0x00 0x00 0x01 0x78 0x01 0x00 0x00 0x00 0x00 0x01 0x79 0x01 0x00 0x00 0x01 0x01 0x01 0x7a 0x01 0x00 0x00 0x01 0x01 0x01 0x7b 0x01 0x00 0x00 0x00 0x00 0x01 0x7c 0x01 0x00 0x00 0x00 0x00 0x01 0x7d 0x01 0x00 0x00 0x00 0x00 0x01 0x7e 0x01 0x00 0x00 0x01 0x01 0x01 0x7f 0x01 0x00 0x00 0x01 0x01 0x01 0x80 0x01 0x00 0x00 0x01 0x01 0x01 0x81 0x01 0x00 0x00 0x01 0x01 0x01 0x82 0x01 0x00 0x00 0x01 0x01 0x01 0x83 0x00 0x01 0x00 0x01 0x00 0x01 0x84 0x00 0x01 0x00 0x01 0x00 0x01 0x85 0x00 0x01 0x00 0x01 0x00 0x01 0x86 0x00 0x01 0x00 0x01 0x00 0x01 0x87 0x00 0x01 0x00 0x01 0x00 0x01 0x88 0x00 0x01 0x01 0x01 0x00 0x01 0x89 0x00 0x01 0x00 0x01 0x00 0x01 0x8a 0x00 0x01 0x00 0x01 0x00 0x01 0x8b 0x00 0x01 0x00 0x01 0x00 0x01 0x8c 0x00 0x01 0x00 0x01 0x00 0x01 0x8d 0x01 0x00 0x00 0x01 0x01 0x01 0x8e 0x01 0x00 0x00 0x01 0x01 0x01 0x8f 0x01 0x00 0x00 0x00 0x00 0x01 0x90 0x01 0x00 0x00 0x00 0x00 0x01 0x91 0x01 0x00 0x00 0x00 0x00 0x01 0x92 0x01 0x00 0x00 0x00 0x00 0x01 0x93 0x01 0x00 0x00 0x00 0x00 0x01 0x94 0x01 0x00 0x00 0x00 0x00 0x01 0x95 0x01 0x00 0x00 0x01 0x00 0x01 0x96 0x01 0x00 0x00 0x01 0x00 0x01 0x97 0x01 0x00 0x00 0x01 0x00 0x01 0x98 0x01 0x00 0x00 0x00 0x00 0x01 0x99 0x01 0x00 0x00 0x00 0x00 0x01 0x9a 0x01 0x00 0x00 0x00 0x00 0x01 0x9b 0x01 0x00 0x00 0x00 0x00 0x01 0x9c 0x01 0x00 0x00 0x00 0x00 0x01 0x9d 0x01 0x00 0x00 0x00 0x00 0x01 0x9e 0x01 0x00 0x00 0x00 0x00 0x01 0x9f 0x01 0x00 0x00 0x01 0x00 0x01 0xa0 0x01 0x00 0x00 0x01 0x00 0x01 0xa1 0x01 0x00 0x00 0x01 0x00 0x01 0xa2 0x01 0x00 0x00 0x00 0x00 0x00 0xa3 0x01 0x00 0x00 0x01 0x00 0x00 0xa4 0x01 0x00 0x00 0x01 0x00 0x01 0xa5 0x01 0x00 0x00 0x01 0x00 0x01 0xa6 0x01 0x00 0x00 0x00 0x00 0x01 0xa7 0x01 0x00 0x00 0x00 0x00 0x01 0xa8 0x01 0x00 0x00 0x00 0x00 0x01 0xa9 0x00 0x01 0x01 0x00 0x00 0x01 0xaa 0x01 0x00 0x00 0x00 0x00 0x01 0xab 0x01 0x00 0x00 0x00 0x00 0x01 0xac 0x01 0x00 0x00 0x00 0x00 0x01 0xad 0x01 0x00 0x00 0x00 0x00 0x01 0xae 0x01 0x00 0x00 0x00 0x00 0x01 0xaf 0x01 0x00 0x00 0x00 0x00 0x01 0xb0 0x01 0x00 0x00 0x00 0x00 0x01 0xb1 0x01 0x00 0x00 0x00 0x00 0x01 0xb2 0x01 0x00 0x00 0x00 0x00 0x01 0xb3 0x01 0x00 0x00 0x00 0x00 0x01 0xb4 0x01 0x00 0x00 0x00 0x00 0x01 0xb5 0x01 0x00 0x00 0x00 0x00 0x01 0xb6 0x01 0x00 0x00 0x00 0x00 0x01 0xb7 0x01 0x00 0x00 0x00 0x00 0x01 0xb8 0x01 0x00 0x00 0x00 0x00 0x01 0xb9 0x01 0x00 0x00 0x00 0x00 0x01 0xba 0x01 0x00 0x00 0x00 0x00 0x01 0xbb 0x01 0x00 0x00 0x00 0x00 0x01 0xbc 0x01 0x00 0x00 0x00 0x00 0x00 0xbd 0x01 0x00 0x00 0x01 0x00 0x00 0xbe 0x01 0x00 0x00 0x00 0x00 0x00 0xbf 0x01 0x00 0x00 0x01 0x00 0x00 0xc0 0x00 0x00 0x00 0x01 0x00 0x01 0xc1 0x00 0x00 0x00 0x01 0x00 0x01 0xc2 0x00 0x00 0x00 0x01 0x00 0x01 0xc3 0x00 0x00 0x00 0x01 0x00 0x01 0xc4 0x00 0x00 0x00 0x01 0x00 0x01 0xc5 0x00 0x00 0x00 0x01 0x00 0x01 0xc6 0x00 0x00 0x00 0x01 0x00 0x01 0xc7 0x00 0x00 0x00 0x01 0x00 0x01 0xc8 0x00 0x00 0x00 0x01 0x00 0x01 0xc9 0x00 0x00 0x00 0x01 0x00 0x01 0xca 0x00 0x00 0x00 0x01 0x00 0x01 0xcb 0x00 0x00 0x00 0x01 0x00 0x00 0xcc 0x00 0x00 0x00 0x01 0x00 0x00 0xcd 0x00 0x00 0x00 0x01 0x00 0x00 0xce 0x00 0x00 0x00 0x01 0x00 0x00 0xcf 0x00 0x00 0x00 0x01 0x00 0x00 0xd0 0x00 0x00 0x00 0x01 0x00 0x00 0xd1 0x00 0x00 0x00 0x01 0x00 0x00 0xd2 0x00 0x00 0x00 0x01 0x00 0x00 0xd3 0x00 0x00 0x00 0x01 0x00 0x00>;
		};
	};

	fragment@40 {
		target = <&mrdump_ext_rst>;

		__overlay__ {
			interrupt-parent = <&pio>;
			interrupts = <0x01 0x08>;
			deb-gpios = <&pio>, <0x01 0x00>;
			debounce = <0x7d000>;
			status = "okay";
		};
	};

	fragment@41 {
		target = <&tcpc_pd>;

		__overlay__ {
			interrupt-parent = <&pio>;
			interrupts = <0x09 0x02>;
			status = "okay";
		};
	};

	fragment@42 {
		target = <&subpmic_pmu_eint>;

		__overlay__ {
			interrupt-parent = <&pio>;
			interrupts = <0x0a 0x02>;
			status = "okay";
		};
	};

	fragment@43 {
		target = <&touch>;

		__overlay__ {
			interrupt-parent = <&pio>;
			interrupts = <0x0e 0x08>;
			status = "okay";
		};
	};

	fragment@44 {
		target = <&dsi_te>;

		__overlay__ {
			interrupt-parent = <&pio>;
			interrupts = <0x20 0x01>;
			status = "okay";
		};
	};

	fragment@45 {
		target = <&md1_sim1_hot_plug_eint>;

		__overlay__ {
			compatible = "mediatek,md1_sim1_hot_plug_eint-eint";
			interrupts = <0x00 0x08>;
			debounce = <0x00 0xc350>;
			dedicated = <0x00 0x00>;
			src_pin = <0x00 0x01>;
			sockettype = <0x00 0x00>;
			status = "okay";
		};
	};

	fragment@46 {
		target = <&mt_pmic_vcamio_ldo_reg>;

		__overlay__ {
			regulator-name = "vcamio";
			regulator-default-on = <0x01>;
			status = "okay";
		};
	};

	fragment@47 {
		target = <&mt_pmic_vtp_ldo_reg>;

		__overlay__ {
			regulator-name = "vtp";
			regulator-default-on = <0x01>;
			status = "okay";
		};
	};

	fragment@48 {
		target = <&kd_camera_hw1>;

		__overlay__ {
			vcamaf-supply = <&mt_pmic_vcamio_ldo_reg>;
			vcamaf_sub-supply = <&mt_pmic_vcamio_ldo_reg>;
			status = "okay";
		};
	};

	fragment@49 {
		target = <&touch>;

		__overlay__ {
			vtouch-supply = <&mt_pmic_vtp_ldo_reg>;
			status = "okay";
		};
	};

	fragment@50 {
		target = <&keypad>;

		__overlay__ {
			mediatek,kpd-key-debounce = <0x400>;
			mediatek,kpd-sw-pwrkey = <0x74>;
			mediatek,kpd-hw-pwrkey = <0x08>;
			mediatek,kpd-use-extend-type = <0x00>;
			mediatek,kpd-hw-map-num = <0x48>;
			mediatek,kpd-hw-init-map = <0x73 0x72 0x00 0x00 0x00 0x00 0x00 0x00 0x00 0x00 0x00 0x00 0x00 0x00 0x00 0x00 0x00 0x00 0x00 0x00 0x00 0x00 0x00 0x00 0x00 0x00 0x00 0x00 0x00 0x00 0x00 0x00 0x00 0x00 0x00 0x00 0x00 0x00 0x00 0x00 0x00 0x00 0x00 0x00 0x00 0x00 0x00 0x00 0x00 0x00 0x00 0x00 0x00 0x00 0x00 0x00 0x00 0x00 0x00 0x00 0x00 0x00 0x00 0x00 0x00 0x00 0x00 0x00 0x00 0x00 0x00 0x00>;
			mediatek,kpd-pwrkey-eint-gpio = <0x00>;
			mediatek,kpd-pwkey-gpio-din = <0x00>;
			keypad,num-rows = <0x06>;
			keypad,num-columns = <0x06>;
			/* MATRIX_KEY(0, 0, KEY_VOLUMEUP), MATRIX_KEY(0, 1, KEY_VOLUMEDOWN) */
			linux,keymap = <0x00000073 0x00010072>;
			debounce-delay-ms = <0x20>;
			wakeup-source;
			status = "okay";
		};
	};

	fragment@51 {
		target = <&pio>;

		__overlay__ {

			mtkfb_pins_lcd_bias_enp1: lcd_bias_enp1_gpio {
				phandle = <0x4d>;

				pins_cmd_dat {
					pinmux = <0x8900>;
					slew-rate = <0x01>;
					output-high;
				};
			};

			mtkfb_pins_lcd_bias_enp0: lcd_bias_enp0_gpio {
				phandle = <0x4e>;

				pins_cmd_dat {
					pinmux = <0x8900>;
					slew-rate = <0x01>;
					output-low;
				};
			};

			mtkfb_pins_lcd_bias_enn1: lcd_bias_enn1_gpio {
				phandle = <0x4f>;

				pins_cmd_dat {
					pinmux = <0x8a00>;
					slew-rate = <0x01>;
					output-high;
				};
			};

			mtkfb_pins_lcd_bias_enn0: lcd_bias_enn0_gpio {
				phandle = <0x50>;

				pins_cmd_dat {
					pinmux = <0x8a00>;
					slew-rate = <0x01>;
					output-low;
				};
			};

			mtkfb_pins_lcm_rst_out1_gpio: lcm_rst_out1_gpio {
				phandle = <0x51>;

				pins_cmd_dat {
					pinmux = <0x5600>;
					slew-rate = <0x01>;
					output-high;
				};
			};

			mtkfb_pins_lcm_rst_out0_gpio: lcm_rst_out0_gpio {
				phandle = <0x52>;

				pins_cmd_dat {
					pinmux = <0x5600>;
					slew-rate = <0x01>;
					output-low;
				};
			};

			mtkfb_pins_lcm_dsi_te: lcm_dsi_te {
				phandle = <0x53>;

				pins_cmd_dat {
					pinmux = <0x5401>;
				};
			};
		};
	};

	fragment@52 {
		target = <&camera_af_hw_node>;

		__overlay__ {
			vcamaf-supply = <&mt_pmic_vcamio_ldo_reg>;
			status = "okay";
		};
	};

	fragment@53 {
		target = <&mtkfb>;

		__overlay__ {
			pinctrl-names = "lcd_bias_enp1_gpio", "lcd_bias_enp0_gpio", "lcd_bias_enn1_gpio", "lcd_bias_enn0_gpio", "lcm_rst_out1_gpio", "lcm_rst_out0_gpio", "mode_te_te";
			pinctrl-0 = <&mtkfb_pins_lcd_bias_enp1>;
			pinctrl-1 = <&mtkfb_pins_lcd_bias_enp0>;
			pinctrl-2 = <&mtkfb_pins_lcd_bias_enn1>;
			pinctrl-3 = <&mtkfb_pins_lcd_bias_enn0>;
			pinctrl-4 = <&mtkfb_pins_lcm_rst_out1_gpio>;
			pinctrl-5 = <&mtkfb_pins_lcm_rst_out0_gpio>;
			pinctrl-6 = <&mtkfb_pins_lcm_dsi_te>;
			status = "okay";
		};
	};

	fragment@54 {
		target = <&dispsys_config>;

		__overlay__ {
			pinctrl-names = "lcm_rst_out1_gpio", "lcm_rst_out0_gpio", "mode_te_te";
			pinctrl-0 = <&mtkfb_pins_lcm_rst_out1_gpio>;
			pinctrl-1 = <&mtkfb_pins_lcm_rst_out0_gpio>;
			pinctrl-2 = <&mtkfb_pins_lcm_dsi_te>;
			status = "okay";
		};
	};

	fragment@55 {
		target = <&dsi0>;

		__overlay__ {
			status = "okay";
			#address-cells = <0x01>;
			#size-cells = <0x00>;

			panel1@0 {
				compatible = "j22_43_03_0b,vdo";
				reg = <0x00>;
				reset-gpios = <&pio>, <0x56 0x00>;
				bias-gpios = <&pio>, <0x89 0x00>, <&pio>, <0x8a 0x00>;

				port {

					panel_in1: endpoint {
						remote-endpoint = <&dsi_out>;
						phandle = <0x55>;
					};
				};
			};

			panel2@0 {
				compatible = "j22_42_02_0a,vdo";
				reg = <0x01>;
				reset-gpios = <&pio>, <0x56 0x00>;
				bias-gpios = <&pio>, <0x89 0x00>, <&pio>, <0x8a 0x00>;

				port {

					panel_in2: endpoint {
						remote-endpoint = <&dsi_out>;
						phandle = <0x7b>;
					};
				};
			};

			panel3@0 {
				compatible = "j22_43_03_0c,vdo";
				reg = <0x02>;
				reset-gpios = <&pio>, <0x56 0x00>;
				bias-gpios = <&pio>, <0x89 0x00>, <&pio>, <0x8a 0x00>;

				port {

					panel_in3: endpoint {
						remote-endpoint = <&dsi_out>;
						phandle = <0x7c>;
					};
				};
			};

			ports {

				port {

					dsi_out: endpoint {
						remote-endpoint = <&panel_in1>;
						phandle = <0x54>;
					};
				};
			};
		};
	};

	fragment@56 {
		target = <&accdet>;

		__overlay__ {
			accdet-mic-vol = <0x08>;
			headset-mode-setting = <0x500 0x500 0x01 0x1f0 0x800 0x800 0x20 0x44 0x04 0x01 0x05 0x03 0x03 0x05 0x0e>;
			accdet-plugout-debounce = <0x01>;
			accdet-mic-mode = <0x02>;
			headset-three-key-threshold = <0x00 0x50 0xdc 0x190>;
			headset-three-key-threshold-CDD = <0x00 0x79 0xc0 0x258>;
			headset-four-key-threshold = <0x00 0x3a 0x79 0xc0 0x190>;
			eint_use_ext_res = <0x00>;
			status = "okay";
		};
	};

	fragment@57 {
		target = <&irtx_pwm>;

		__overlay__ {
			pwm_ch = <0x02>;
			pinctrl-names = "irtx_gpio_led_default", "irtx_gpio_led_set";
			pinctrl-0 = <&irtx_gpio_led_default>;
			pinctrl-1 = <&irtx_gpio_led_set>;
			status = "okay";
		};
	};

	fragment@58 {
		target = <&pio>;

		__overlay__ {

			irtx_gpio_led_default: irtx_gpio_led_def@gpio139 {
				phandle = <0x56>;

				pins_cmd_dat {
					pinmux = <0x8b00>;
					slew-rate = <0x01>;
					bias-disable;
					output-low;
					input-schmitt-enable = <0x00>;
				};
			};

			irtx_gpio_led_set: irtx_gpio_led_set@gpio139 {
				phandle = <0x57>;

				pins_cmd_dat {
					pinmux = <0x8b01>;
					slew-rate = <0x01>;
					output-high;
				};
			};
		};
	};

	fragment@59 {
		target = <&pio>;

		__overlay__ {

			ts_int_active: ts_int_active {
				phandle = <0x58>;

				pins_cmd_dat {
					pinmux = <0xe00>;
					slew-rate = <0x00>;
					bias-pull-down = <0x0b>;
				};
			};

			ts_reset_active: ts_reset_active {
				phandle = <0x59>;

				pins_cmd_dat {
					pinmux = <0xf00>;
					slew-rate = <0x00>;
					bias-pull-up = <0x0b>;
					output-high;
				};
			};

			ts_int_suspend: ts_int_suspend {
				phandle = <0x5a>;

				pins_cmd_dat {
					pinmux = <0xe00>;
					slew-rate = <0x00>;
					bias-disable;
				};
			};

			ts_reset_suspend: ts_reset_suspend {
				phandle = <0x5b>;

				pins_cmd_dat {
					pinmux = <0xf00>;
					slew-rate = <0x00>;
					bias-disable;
					output-low;
				};
			};
		};
	};

	fragment@60 {
		target = <&ts_novatek>;

		__overlay__ {
			compatible = "novatek,NVT-ts-spi";
			status = "ok";
			spi-max-frequency = <0x4c4b40>;
			novatek,reset-gpio = <&pio>, <0x0f 0x00>;
			novatek,irq-gpio = <&pio>, <0x0e 0x2001>;
			pinctrl-names = "pmx_ts_active", "pmx_ts_suspend";
			pinctrl-0 = <&ts_int_active>, <&ts_reset_active>;
			pinctrl-1 = <&ts_int_suspend>, <&ts_reset_suspend>;
			novatek,swrst-n8-addr = <0x3f0fe>;
			novatek,spi-rd-fast-addr = <0x3f310>;
			novatek,config-array-size = <0x02>;

			novatek,cfg_0 {
				novatek,tp-vendor = <0x53>;
				novatek,display-maker = <0x42>;
				novatek,fw-name = "novatek_nt36672a_g7_fw01.bin";
				novatek,mp-name = "novatek_nt36672a_g7_mp01.bin";
				novatek,clicknum-file-name = "nvt+csot";
			};

			novatek,cfg_1 {
				novatek,tp-vendor = <0x46>;
				novatek,display-maker = <0x36>;
				novatek,fw-name = "novatek_nt36672a_g7_fw02.bin";
				novatek,mp-name = "novatek_nt36672a_g7_mp02.bin";
				novatek,clicknum-file-name = "nvt+tianma";
			};

			novatek-mp-criteria-nvtpid@0 {
				#address-cells = <0x01>;
				#size-cells = <0x00>;
				compatible = "novatek-mp-criteria-nvtpid";
				IC_X_CFG_SIZE = <0x12>;
				IC_Y_CFG_SIZE = <0x24>;
				IC_KEY_CFG_SIZE = <0x04>;
				X_Channel = <0x12>;
				Y_Channel = <0x24>;
				AIN_X = <0x00 0x01 0x02 0x03 0x04 0x05 0x06 0x07 0x08 0x09 0x0a 0x0b 0x0c 0x0d 0x0e 0x0f 0x10 0x11>;
				AIN_Y = <0x00 0x01 0x02 0x03 0x04 0x05 0x06 0x07 0x08 0x09 0x0a 0x0b 0x0c 0x0d 0x0e 0x0f 0x10 0x11 0x12 0x13 0x14 0x15 0x16 0x17 0x18 0x19 0x1a 0x1b 0x1c 0x1d 0x1e 0x1f 0x20 0x21 0x22 0x23>;
				AIN_KEY = <0x00 0x01 0x02 0xff>;
				PS_Config_Lmt_Short_Rawdata_P = <0x36b8 0x36b8 0x36b8 0x36b8 0x36b8 0x36b8 0x36b8 0x36b8 0x36b8 0x36b8 0x36b8 0x36b8 0x36b8 0x36b8 0x36b8 0x36b8 0x36b8 0x36b8 0x36b8 0x36b8 0x36b8 0x36b8 0x36b8 0x36b8 0x36b8 0x36b8 0x36b8 0x36b8 0x36b8 0x36b8 0x36b8 0x36b8 0x36b8 0x36b8 0x36b8 0x36b8 0x36b8 0x36b8 0x36b8 0x36b8 0x36b8 0x36b8 0x36b8 0x36b8 0x36b8 0x36b8 0x36b8 0x36b8 0x36b8 0x36b8 0x36b8 0x36b8 0x36b8 0x36b8 0x36b8 0x36b8 0x36b8 0x36b8 0x36b8 0x36b8 0x36b8 0x36b8 0x36b8 0x36b8 0x36b8 0x36b8 0x36b8 0x36b8 0x36b8 0x36b8 0x36b8 0x36b8 0x36b8 0x36b8 0x36b8 0x36b8 0x36b8 0x36b8 0x36b8 0x36b8 0x36b8 0x36b8 0x36b8 0x36b8 0x36b8 0x36b8 0x36b8 0x36b8 0x36b8 0x36b8 0x36b8 0x36b8 0x36b8 0x36b8 0x36b8 0x36b8 0x36b8 0x36b8 0x36b8 0x36b8 0x36b8 0x36b8 0x36b8 0x36b8 0x36b8 0x36b8 0x36b8 0x36b8 0x36b8 0x36b8 0x36b8 0x36b8 0x36b8 0x36b8 0x36b8 0x36b8 0x36b8 0x36b8 0x36b8 0x36b8 0x36b8 0x36b8 0x36b8 0x36b8 0x36b8 0x36b8 0x36b8 0x36b8 0x36b8 0x36b8 0x36b8 0x36b8 0x36b8 0x36b8 0x36b8 0x36b8 0x36b8 0x36b8 0x36b8 0x36b8 0x36b8 0x36b8 0x36b8 0x36b8 0x36b8 0x36b8 0x36b8 0x36b8 0x36b8 0x36b8 0x36b8 0x36b8 0x36b8 0x36b8 0x36b8 0x36b8 0x36b8 0x36b8 0x36b8 0x36b8 0x36b8 0x36b8 0x36b8 0x36b8 0x36b8 0x36b8 0x36b8 0x36b8 0x36b8 0x36b8 0x36b8 0x36b8 0x36b8 0x36b8 0x36b8 0x36b8 0x36b8 0x36b8 0x36b8 0x36b8 0x36b8 0x36b8 0x36b8 0x36b8 0x36b8 0x36b8 0x36b8 0x36b8 0x36b8 0x36b8 0x36b8 0x36b8 0x36b8 0x36b8 0x36b8 0x36b8 0x36b8 0x36b8 0x36b8 0x36b8 0x36b8 0x36b8 0x36b8 0x36b8 0x36b8 0x36b8 0x36b8 0x36b8 0x36b8 0x36b8 0x36b8 0x36b8 0x36b8 0x36b8 0x36b8 0x36b8 0x36b8 0x36b8 0x36b8 0x36b8 0x36b8 0x36b8 0x36b8 0x36b8 0x36b8 0x36b8 0x36b8 0x36b8 0x36b8 0x36b8 0x36b8 0x36b8 0x36b8 0x36b8 0x36b8 0x36b8 0x36b8 0x36b8 0x36b8 0x36b8 0x36b8 0x36b8 0x36b8 0x36b8 0x36b8 0x36b8 0x36b8 0x36b8 0x36b8 0x36b8 0x36b8 0x36b8 0x36b8 0x36b8 0x36b8 0x36b8 0x36b8 0x36b8 0x36b8 0x36b8 0x36b8 0x36b8 0x36b8 0x36b8 0x36b8 0x36b8 0x36b8 0x36b8 0x36b8 0x36b8 0x36b8 0x36b8 0x36b8 0x36b8 0x36b8 0x36b8 0x36b8 0x36b8 0x36b8 0x36b8 0x36b8 0x36b8 0x36b8 0x36b8 0x36b8 0x36b8 0x36b8 0x36b8 0x36b8 0x36b8 0x36b8 0x36b8 0x36b8 0x36b8 0x36b8 0x36b8 0x36b8 0x36b8 0x36b8 0x36b8 0x36b8 0x36b8 0x36b8 0x36b8 0x36b8 0x36b8 0x36b8 0x36b8 0x36b8 0x36b8 0x36b8 0x36b8 0x36b8 0x36b8 0x36b8 0x36b8 0x36b8 0x36b8 0x36b8 0x36b8 0x36b8 0x36b8 0x36b8 0x36b8 0x36b8 0x36b8 0x36b8 0x36b8 0x36b8 0x36b8 0x36b8 0x36b8 0x36b8 0x36b8 0x36b8 0x36b8 0x36b8 0x36b8 0x36b8 0x36b8 0x36b8 0x36b8 0x36b8 0x36b8 0x36b8 0x36b8 0x36b8 0x36b8 0x36b8 0x36b8 0x36b8 0x36b8 0x36b8 0x36b8 0x36b8 0x36b8 0x36b8 0x36b8 0x36b8 0x36b8 0x36b8 0x36b8 0x36b8 0x36b8 0x36b8 0x36b8 0x36b8 0x36b8 0x36b8 0x36b8 0x36b8 0x36b8 0x36b8 0x36b8 0x36b8 0x36b8 0x36b8 0x36b8 0x36b8 0x36b8 0x36b8 0x36b8 0x36b8 0x36b8 0x36b8 0x36b8 0x36b8 0x36b8 0x36b8 0x36b8 0x36b8 0x36b8 0x36b8 0x36b8 0x36b8 0x36b8 0x36b8 0x36b8 0x36b8 0x36b8 0x36b8 0x36b8 0x36b8 0x36b8 0x36b8 0x36b8 0x36b8 0x36b8 0x36b8 0x36b8 0x36b8 0x36b8 0x36b8 0x36b8 0x36b8 0x36b8 0x36b8 0x36b8 0x36b8 0x36b8 0x36b8 0x36b8 0x36b8 0x36b8 0x36b8 0x36b8 0x36b8 0x36b8 0x36b8 0x36b8 0x36b8 0x36b8 0x36b8 0x36b8 0x36b8 0x36b8 0x36b8 0x36b8 0x36b8 0x36b8 0x36b8 0x36b8 0x36b8 0x36b8 0x36b8 0x36b8 0x36b8 0x36b8 0x36b8 0x36b8 0x36b8 0x36b8 0x36b8 0x36b8 0x36b8 0x36b8 0x36b8 0x36b8 0x36b8 0x36b8 0x36b8 0x36b8 0x36b8 0x36b8 0x36b8 0x36b8 0x36b8 0x36b8 0x36b8 0x36b8 0x36b8 0x36b8 0x36b8 0x36b8 0x36b8 0x36b8 0x36b8 0x36b8 0x36b8 0x36b8 0x36b8 0x36b8 0x36b8 0x36b8 0x36b8 0x36b8 0x36b8 0x36b8 0x36b8 0x36b8 0x36b8 0x36b8 0x36b8 0x36b8 0x36b8 0x36b8 0x36b8 0x36b8 0x36b8 0x36b8 0x36b8 0x36b8 0x36b8 0x36b8 0x36b8 0x36b8 0x36b8 0x36b8 0x36b8 0x36b8 0x36b8 0x36b8 0x36b8 0x36b8 0x36b8 0x36b8 0x36b8 0x36b8 0x36b8 0x36b8 0x36b8 0x36b8 0x36b8 0x36b8 0x36b8 0x36b8 0x36b8 0x36b8 0x36b8 0x36b8 0x36b8 0x36b8 0x36b8 0x36b8 0x36b8 0x36b8 0x36b8 0x36b8 0x36b8 0x36b8 0x36b8 0x36b8 0x36b8 0x36b8 0x36b8 0x36b8 0x36b8 0x36b8 0x36b8 0x36b8 0x36b8 0x36b8 0x36b8 0x36b8 0x36b8 0x36b8 0x36b8 0x36b8 0x36b8 0x36b8 0x36b8 0x36b8 0x36b8 0x36b8 0x36b8 0x36b8 0x36b8 0x36b8 0x36b8 0x36b8 0x36b8 0x36b8 0x36b8 0x36b8 0x36b8 0x36b8 0x36b8 0x36b8 0x36b8 0x36b8 0x36b8 0x36b8 0x36b8 0x36b8 0x36b8 0x36b8 0x36b8 0x36b8 0x36b8 0x36b8 0x36b8 0x36b8 0x36b8 0x36b8 0x36b8 0x36b8 0x36b8 0x36b8 0x36b8 0x36b8 0x36b8 0x36b8 0x36b8 0x36b8 0x36b8 0x36b8 0x36b8 0x36b8 0x36b8 0x36b8 0x36b8 0x36b8 0x36b8 0x36b8 0x36b8 0x36b8 0x36b8 0x36b8 0x36b8 0x36b8 0x36b8 0x36b8 0x36b8 0x36b8 0x36b8 0x36b8 0x36b8 0x36b8 0x36b8 0x36b8 0x36b8 0x36b8 0x36b8 0x36b8 0x36b8 0x36b8 0x36b8 0x36b8 0x36b8 0x36b8 0x36b8 0x36b8 0x36b8 0x36b8 0x36b8 0x36b8 0x36b8 0x36b8 0x36b8 0x36b8 0x36b8>;
				PS_Config_Lmt_Short_Rawdata_N = <0x2710 0x2710 0x2710 0x2710 0x2710 0x2710 0x2710 0x2710 0x2710 0x2710 0x2710 0x2710 0x2710 0x2710 0x2710 0x2710 0x2710 0x2710 0x2710 0x2710 0x2710 0x2710 0x2710 0x2710 0x2710 0x2710 0x2710 0x2710 0x2710 0x2710 0x2710 0x2710 0x2710 0x2710 0x2710 0x2710 0x2710 0x2710 0x2710 0x2710 0x2710 0x2710 0x2710 0x2710 0x2710 0x2710 0x2710 0x2710 0x2710 0x2710 0x2710 0x2710 0x2710 0x2710 0x2710 0x2710 0x2710 0x2710 0x2710 0x2710 0x2710 0x2710 0x2710 0x2710 0x2710 0x2710 0x2710 0x2710 0x2710 0x2710 0x2710 0x2710 0x2710 0x2710 0x2710 0x2710 0x2710 0x2710 0x2710 0x2710 0x2710 0x2710 0x2710 0x2710 0x2710 0x2710 0x2710 0x2710 0x2710 0x2710 0x2710 0x2710 0x2710 0x2710 0x2710 0x2710 0x2710 0x2710 0x2710 0x2710 0x2710 0x2710 0x2710 0x2710 0x2710 0x2710 0x2710 0x2710 0x2710 0x2710 0x2710 0x2710 0x2710 0x2710 0x2710 0x2710 0x2710 0x2710 0x2710 0x2710 0x2710 0x2710 0x2710 0x2710 0x2710 0x2710 0x2710 0x2710 0x2710 0x2710 0x2710 0x2710 0x2710 0x2710 0x2710 0x2710 0x2710 0x2710 0x2710 0x2710 0x2710 0x2710 0x2710 0x2710 0x2710 0x2710 0x2710 0x2710 0x2710 0x2710 0x2710 0x2710 0x2710 0x2710 0x2710 0x2710 0x2710 0x2710 0x2710 0x2710 0x2710 0x2710 0x2710 0x2710 0x2710 0x2710 0x2710 0x2710 0x2710 0x2710 0x2710 0x2710 0x2710 0x2710 0x2710 0x2710 0x2710 0x2710 0x2710 0x2710 0x2710 0x2710 0x2710 0x2710 0x2710 0x2710 0x2710 0x2710 0x2710 0x2710 0x2710 0x2710 0x2710 0x2710 0x2710 0x2710 0x2710 0x2710 0x2710 0x2710 0x2710 0x2710 0x2710 0x2710 0x2710 0x2710 0x2710 0x2710 0x2710 0x2710 0x2710 0x2710 0x2710 0x2710 0x2710 0x2710 0x2710 0x2710 0x2710 0x2710 0x2710 0x2710 0x2710 0x2710 0x2710 0x2710 0x2710 0x2710 0x2710 0x2710 0x2710 0x2710 0x2710 0x2710 0x2710 0x2710 0x2710 0x2710 0x2710 0x2710 0x2710 0x2710 0x2710 0x2710 0x2710 0x2710 0x2710 0x2710 0x2710 0x2710 0x2710 0x2710 0x2710 0x2710 0x2710 0x2710 0x2710 0x2710 0x2710 0x2710 0x2710 0x2710 0x2710 0x2710 0x2710 0x2710 0x2710 0x2710 0x2710 0x2710 0x2710 0x2710 0x2710 0x2710 0x2710 0x2710 0x2710 0x2710 0x2710 0x2710 0x2710 0x2710 0x2710 0x2710 0x2710 0x2710 0x2710 0x2710 0x2710 0x2710 0x2710 0x2710 0x2710 0x2710 0x2710 0x2710 0x2710 0x2710 0x2710 0x2710 0x2710 0x2710 0x2710 0x2710 0x2710 0x2710 0x2710 0x2710 0x2710 0x2710 0x2710 0x2710 0x2710 0x2710 0x2710 0x2710 0x2710 0x2710 0x2710 0x2710 0x2710 0x2710 0x2710 0x2710 0x2710 0x2710 0x2710 0x2710 0x2710 0x2710 0x2710 0x2710 0x2710 0x2710 0x2710 0x2710 0x2710 0x2710 0x2710 0x2710 0x2710 0x2710 0x2710 0x2710 0x2710 0x2710 0x2710 0x2710 0x2710 0x2710 0x2710 0x2710 0x2710 0x2710 0x2710 0x2710 0x2710 0x2710 0x2710 0x2710 0x2710 0x2710 0x2710 0x2710 0x2710 0x2710 0x2710 0x2710 0x2710 0x2710 0x2710 0x2710 0x2710 0x2710 0x2710 0x2710 0x2710 0x2710 0x2710 0x2710 0x2710 0x2710 0x2710 0x2710 0x2710 0x2710 0x2710 0x2710 0x2710 0x2710 0x2710 0x2710 0x2710 0x2710 0x2710 0x2710 0x2710 0x2710 0x2710 0x2710 0x2710 0x2710 0x2710 0x2710 0x2710 0x2710 0x2710 0x2710 0x2710 0x2710 0x2710 0x2710 0x2710 0x2710 0x2710 0x2710 0x2710 0x2710 0x2710 0x2710 0x2710 0x2710 0x2710 0x2710 0x2710 0x2710 0x2710 0x2710 0x2710 0x2710 0x2710 0x2710 0x2710 0x2710 0x2710 0x2710 0x2710 0x2710 0x2710 0x2710 0x2710 0x2710 0x2710 0x2710 0x2710 0x2710 0x2710 0x2710 0x2710 0x2710 0x2710 0x2710 0x2710 0x2710 0x2710 0x2710 0x2710 0x2710 0x2710 0x2710 0x2710 0x2710 0x2710 0x2710 0x2710 0x2710 0x2710 0x2710 0x2710 0x2710 0x2710 0x2710 0x2710 0x2710 0x2710 0x2710 0x2710 0x2710 0x2710 0x2710 0x2710 0x2710 0x2710 0x2710 0x2710 0x2710 0x2710 0x2710 0x2710 0x2710 0x2710 0x2710 0x2710 0x2710 0x2710 0x2710 0x2710 0x2710 0x2710 0x2710 0x2710 0x2710 0x2710 0x2710 0x2710 0x2710 0x2710 0x2710 0x2710 0x2710 0x2710 0x2710 0x2710 0x2710 0x2710 0x2710 0x2710 0x2710 0x2710 0x2710 0x2710 0x2710 0x2710 0x2710 0x2710 0x2710 0x2710 0x2710 0x2710 0x2710 0x2710 0x2710 0x2710 0x2710 0x2710 0x2710 0x2710 0x2710 0x2710 0x2710 0x2710 0x2710 0x2710 0x2710 0x2710 0x2710 0x2710 0x2710 0x2710 0x2710 0x2710 0x2710 0x2710 0x2710 0x2710 0x2710 0x2710 0x2710 0x2710 0x2710 0x2710 0x2710 0x2710 0x2710 0x2710 0x2710 0x2710 0x2710 0x2710 0x2710 0x2710 0x2710 0x2710 0x2710 0x2710 0x2710 0x2710 0x2710 0x2710 0x2710 0x2710 0x2710 0x2710 0x2710 0x2710 0x2710 0x2710 0x2710 0x2710 0x2710 0x2710 0x2710 0x2710 0x2710 0x2710 0x2710 0x2710 0x2710 0x2710 0x2710 0x2710 0x2710 0x2710 0x2710 0x2710 0x2710 0x2710 0x2710 0x2710 0x2710 0x2710 0x2710 0x2710 0x2710 0x2710 0x2710 0x2710 0x2710 0x2710 0x2710 0x2710 0x2710 0x2710 0x2710 0x2710 0x2710 0x2710 0x2710 0x2710 0x2710 0x2710 0x2710 0x2710 0x2710 0x2710 0x2710 0x2710 0x2710 0x2710 0x2710 0x2710 0x2710 0x2710 0x2710 0x2710 0x2710 0x2710 0x2710 0x2710 0x2710 0x2710>;
				PS_Config_Lmt_Open_Rawdata_P = <0x1000 0x1000 0x1000 0x1000 0x1000 0x1000 0x1000 0x1000 0x1000 0x1000 0x1000 0x1000 0x1000 0x1000 0x1000 0x1000 0x1000 0x1000 0x1000 0x1000 0x1000 0x1000 0x1000 0x1000 0x1000 0x1000 0x1000 0x1000 0x1000 0x1000 0x1000 0x1000 0x1000 0x1000 0x1000 0x1000 0x1000 0x1000 0x1000 0x1000 0x1000 0x1000 0x1000 0x1000 0x1000 0x1000 0x1000 0x1000 0x1000 0x1000 0x1000 0x1000 0x1000 0x1000 0x1000 0x1000 0x1000 0x1000 0x1000 0x1000 0x1000 0x1000 0x1000 0x1000 0x1000 0x1000 0x1000 0x1000 0x1000 0x1000 0x1000 0x1000 0x1000 0x1000 0x1000 0x1000 0x1000 0x1000 0x1000 0x1000 0x1000 0x1000 0x1000 0x1000 0x1000 0x1000 0x1000 0x1000 0x1000 0x1000 0x1000 0x1000 0x1000 0x1000 0x1000 0x1000 0x1000 0x1000 0x1000 0x1000 0x1000 0x1000 0x1000 0x1000 0x1000 0x1000 0x1000 0x1000 0x1000 0x1000 0x1000 0x1000 0x1000 0x1000 0x1000 0x1000 0x1000 0x1000 0x1000 0x1000 0x1000 0x1000 0x1000 0x1000 0x1000 0x1000 0x1000 0x1000 0x1000 0x1000 0x1000 0x1000 0x1000 0x1000 0x1000 0x1000 0x1000 0x1000 0x1000 0x1000 0x1000 0x1000 0x1000 0x1000 0x1000 0x1000 0x1000 0x1000 0x1000 0x1000 0x1000 0x1000 0x1000 0x1000 0x1000 0x1000 0x1000 0x1000 0x1000 0x1000 0x1000 0x1000 0x1000 0x1000 0x1000 0x1000 0x1000 0x1000 0x1000 0x1000 0x1000 0x1000 0x1000 0x1000 0x1000 0x1000 0x1000 0x1000 0x1000 0x1000 0x1000 0x1000 0x1000 0x1000 0x1000 0x1000 0x1000 0x1000 0x1000 0x1000 0x1000 0x1000 0x1000 0x1000 0x1000 0x1000 0x1000 0x1000 0x1000 0x1000 0x1000 0x1000 0x1000 0x1000 0x1000 0x1000 0x1000 0x1000 0x1000 0x1000 0x1000 0x1000 0x1000 0x1000 0x1000 0x1000 0x1000 0x1000 0x1000 0x1000 0x1000 0x1000 0x1000 0x1000 0x1000 0x1000 0x1000 0x1000 0x1000 0x1000 0x1000 0x1000 0x1000 0x1000 0x1000 0x1000 0x1000 0x1000 0x1000 0x1000 0x1000 0x1000 0x1000 0x1000 0x1000 0x1000 0x1000 0x1000 0x1000 0x1000 0x1000 0x1000 0x1000 0x1000 0x1000 0x1000 0x1000 0x1000 0x1000 0x1000 0x1000 0x1000 0x1000 0x1000 0x1000 0x1000 0x1000 0x1000 0x1000 0x1000 0x1000 0x1000 0x1000 0x1000 0x1000 0x1000 0x1000 0x1000 0x1000 0x1000 0x1000 0x1000 0x1000 0x1000 0x1000 0x1000 0x1000 0x1000 0x1000 0x1000 0x1000 0x1000 0x1000 0x1000 0x1000 0x1000 0x1000 0x1000 0x1000 0x1000 0x1000 0x1000 0x1000 0x1000 0x1000 0x1000 0x1000 0x1000 0x1000 0x1000 0x1000 0x1000 0x1000 0x1000 0x1000 0x1000 0x1000 0x1000 0x1000 0x1000 0x1000 0x1000 0x1000 0x1000 0x1000 0x1000 0x1000 0x1000 0x1000 0x1000 0x1000 0x1000 0x1000 0x1000 0x1000 0x1000 0x1000 0x1000 0x1000 0x1000 0x1000 0x1000 0x1000 0x1000 0x1000 0x1000 0x1000 0x1000 0x1000 0x1000 0x1000 0x1000 0x1000 0x1000 0x1000 0x1000 0x1000 0x1000 0x1000 0x1000 0x1000 0x1000 0x1000 0x1000 0x1000 0x1000 0x1000 0x1000 0x1000 0x1000 0x1000 0x1000 0x1000 0x1000 0x1000 0x1000 0x1000 0x1000 0x1000 0x1000 0x1000 0x1000 0x1000 0x1000 0x1000 0x1000 0x1000 0x1000 0x1000 0x1000 0x1000 0x1000 0x1000 0x1000 0x1000 0x1000 0x1000 0x1000 0x1000 0x1000 0x1000 0x1000 0x1000 0x1000 0x1000 0x1000 0x1000 0x1000 0x1000 0x1000 0x1000 0x1000 0x1000 0x1000 0x1000 0x1000 0x1000 0x1000 0x1000 0x1000 0x1000 0x1000 0x1000 0x1000 0x1000 0x1000 0x1000 0x1000 0x1000 0x1000 0x1000 0x1000 0x1000 0x1000 0x1000 0x1000 0x1000 0x1000 0x1000 0x1000 0x1000 0x1000 0x1000 0x1000 0x1000 0x1000 0x1000 0x1000 0x1000 0x1000 0x1000 0x1000 0x1000 0x1000 0x1000 0x1000 0x1000 0x1000 0x1000 0x1000 0x1000 0x1000 0x1000 0x1000 0x1000 0x1000 0x1000 0x1000 0x1000 0x1000 0x1000 0x1000 0x1000 0x1000 0x1000 0x1000 0x1000 0x1000 0x1000 0x1000 0x1000 0x1000 0x1000 0x1000 0x1000 0x1000 0x1000 0x1000 0x1000 0x1000 0x1000 0x1000 0x1000 0x1000 0x1000 0x1000 0x1000 0x1000 0x1000 0x1000 0x1000 0x1000 0x1000 0x1000 0x1000 0x1000 0x1000 0x1000 0x1000 0x1000 0x1000 0x1000 0x1000 0x1000 0x1000 0x1000 0x1000 0x1000 0x1000 0x1000 0x1000 0x1000 0x1000 0x1000 0x1000 0x1000 0x1000 0x1000 0x1000 0x1000 0x1000 0x1000 0x1000 0x1000 0x1000 0x1000 0x1000 0x1000 0x1000 0x1000 0x1000 0x1000 0x1000 0x1000 0x1000 0x1000 0x1000 0x1000 0x1000 0x1000 0x1000 0x1000 0x1000 0x1000 0x1000 0x1000 0x1000 0x1000 0x1000 0x1000 0x1000 0x1000 0x1000 0x1000 0x1000 0x1000 0x1000 0x1000 0x1000 0x1000 0x1000 0x1000 0x1000 0x1000 0x1000 0x1000 0x1000 0x1000 0x1000 0x1000 0x1000 0x1000 0x1000 0x1000 0x1000 0x1000 0x1000 0x1000 0x1000 0x1000 0x1000 0x1000 0x1000 0x1000 0x1000 0x1000 0x1000 0x1000 0x1000 0x1000 0x1000 0x1000 0x1000 0x1000 0x1000 0x1000 0x1000 0x1000 0x1000 0x1000 0x1000 0x1000 0x1000 0x1000 0x1000 0x1000 0x1000 0x1000 0x1000 0x1000 0x1000 0x1000 0x1000 0x1000 0x1000 0x1000 0x1000 0x1000 0x1000 0x1000 0x1000 0x1000 0x1000 0x1000 0x1000 0x1000 0x1000 0x1000 0x1000 0x1000 0x1000 0x1000 0x1000 0x1000 0x1000 0x1000 0x1000 0x1000 0x1000 0x1000 0x1000>;
				PS_Config_Lmt_Open_Rawdata_N = <0x32 0x32 0x32 0x32 0x32 0x32 0x32 0x32 0x32 0x32 0x32 0x32 0x32 0x32 0x32 0x32 0x32 0x32 0x32 0x32 0x32 0x32 0x32 0x32 0x32 0x32 0x32 0x32 0x32 0x32 0x32 0x32 0x32 0x32 0x32 0x32 0x32 0x32 0x32 0x32 0x32 0x32 0x32 0x32 0x32 0x32 0x32 0x32 0x32 0x32 0x32 0x32 0x32 0x32 0x32 0x32 0x32 0x32 0x32 0x32 0x32 0x32 0x32 0x32 0x32 0x32 0x32 0x32 0x32 0x32 0x32 0x32 0x32 0x32 0x32 0x32 0x32 0x32 0x32 0x32 0x32 0x32 0x32 0x32 0x32 0x32 0x32 0x32 0x32 0x32 0x32 0x32 0x32 0x32 0x32 0x32 0x32 0x32 0x32 0x32 0x32 0x32 0x32 0x32 0x32 0x32 0x32 0x32 0x32 0x32 0x32 0x32 0x32 0x32 0x32 0x32 0x32 0x32 0x32 0x32 0x32 0x32 0x32 0x32 0x32 0x32 0x32 0x32 0x32 0x32 0x32 0x32 0x32 0x32 0x32 0x32 0x32 0x32 0x32 0x32 0x32 0x32 0x32 0x32 0x32 0x32 0x32 0x32 0x32 0x32 0x32 0x32 0x32 0x32 0x32 0x32 0x32 0x32 0x32 0x32 0x32 0x32 0x32 0x32 0x32 0x32 0x32 0x32 0x32 0x32 0x32 0x32 0x32 0x32 0x32 0x32 0x32 0x32 0x32 0x32 0x32 0x32 0x32 0x32 0x32 0x32 0x32 0x32 0x32 0x32 0x32 0x32 0x32 0x32 0x32 0x32 0x32 0x32 0x32 0x32 0x32 0x32 0x32 0x32 0x32 0x32 0x32 0x32 0x32 0x32 0x32 0x32 0x32 0x32 0x32 0x32 0x32 0x32 0x32 0x32 0x32 0x32 0x32 0x32 0x32 0x32 0x32 0x32 0x32 0x32 0x32 0x32 0x32 0x32 0x32 0x32 0x32 0x32 0x32 0x32 0x32 0x32 0x32 0x32 0x32 0x32 0x32 0x32 0x32 0x32 0x32 0x32 0x32 0x32 0x32 0x32 0x32 0x32 0x32 0x32 0x32 0x32 0x32 0x32 0x32 0x32 0x32 0x32 0x32 0x32 0x32 0x32 0x32 0x32 0x32 0x32 0x32 0x32 0x32 0x32 0x32 0x32 0x32 0x32 0x32 0x32 0x32 0x32 0x32 0x32 0x32 0x32 0x32 0x32 0x32 0x32 0x32 0x32 0x32 0x32 0x32 0x32 0x32 0x32 0x32 0x32 0x32 0x32 0x32 0x32 0x32 0x32 0x32 0x32 0x32 0x32 0x32 0x32 0x32 0x32 0x32 0x32 0x32 0x32 0x32 0x32 0x32 0x32 0x32 0x32 0x32 0x32 0x32 0x32 0x32 0x32 0x32 0x32 0x32 0x32 0x32 0x32 0x32 0x32 0x32 0x32 0x32 0x32 0x32 0x32 0x32 0x32 0x32 0x32 0x32 0x32 0x32 0x32 0x32 0x32 0x32 0x32 0x32 0x32 0x32 0x32 0x32 0x32 0x32 0x32 0x32 0x32 0x32 0x32 0x32 0x32 0x32 0x32 0x32 0x32 0x32 0x32 0x32 0x32 0x32 0x32 0x32 0x32 0x32 0x32 0x32 0x32 0x32 0x32 0x32 0x32 0x32 0x32 0x32 0x32 0x32 0x32 0x32 0x32 0x32 0x32 0x32 0x32 0x32 0x32 0x32 0x32 0x32 0x32 0x32 0x32 0x32 0x32 0x32 0x32 0x32 0x32 0x32 0x32 0x32 0x32 0x32 0x32 0x32 0x32 0x32 0x32 0x32 0x32 0x32 0x32 0x32 0x32 0x32 0x32 0x32 0x32 0x32 0x32 0x32 0x32 0x32 0x32 0x32 0x32 0x32 0x32 0x32 0x32 0x32 0x32 0x32 0x32 0x32 0x32 0x32 0x32 0x32 0x32 0x32 0x32 0x32 0x32 0x32 0x32 0x32 0x32 0x32 0x32 0x32 0x32 0x32 0x32 0x32 0x32 0x32 0x32 0x32 0x32 0x32 0x32 0x32 0x32 0x32 0x32 0x32 0x32 0x32 0x32 0x32 0x32 0x32 0x32 0x32 0x32 0x32 0x32 0x32 0x32 0x32 0x32 0x32 0x32 0x32 0x32 0x32 0x32 0x32 0x32 0x32 0x32 0x32 0x32 0x32 0x32 0x32 0x32 0x32 0x32 0x32 0x32 0x32 0x32 0x32 0x32 0x32 0x32 0x32 0x32 0x32 0x32 0x32 0x32 0x32 0x32 0x32 0x32 0x32 0x32 0x32 0x32 0x32 0x32 0x32 0x32 0x32 0x32 0x32 0x32 0x32 0x32 0x32 0x32 0x32 0x32 0x32 0x32 0x32 0x32 0x32 0x32 0x32 0x32 0x32 0x32 0x32 0x32 0x32 0x32 0x32 0x32 0x32 0x32 0x32 0x32 0x32 0x32 0x32 0x32 0x32 0x32 0x32 0x32 0x32 0x32 0x32 0x32 0x32 0x32 0x32 0x32 0x32 0x32 0x32 0x32 0x32 0x32 0x32 0x32 0x32 0x32 0x32 0x32 0x32 0x32 0x32 0x32 0x32 0x32 0x32 0x32 0x32 0x32 0x32 0x32 0x32 0x32 0x32 0x32 0x32 0x32 0x32 0x32 0x32 0x32 0x32 0x32 0x32 0x32 0x32 0x32 0x32 0x32 0x32 0x32 0x32 0x32 0x32 0x32 0x32 0x32 0x32 0x32 0x32 0x32 0x32>;
				PS_Config_Lmt_FW_Rawdata_P = <0x780 0x780 0x780 0x780 0x780 0x780 0x780 0x780 0x780 0x780 0x780 0x780 0x780 0x780 0x780 0x780 0x780 0x780 0x780 0x780 0x780 0x780 0x780 0x780 0x780 0x780 0x780 0x780 0x780 0x780 0x780 0x780 0x780 0x780 0x780 0x780 0x780 0x780 0x780 0x780 0x780 0x780 0x780 0x780 0x780 0x780 0x780 0x780 0x780 0x780 0x780 0x780 0x780 0x780 0x780 0x780 0x780 0x780 0x780 0x780 0x780 0x780 0x780 0x780 0x780 0x780 0x780 0x780 0x780 0x780 0x780 0x780 0x780 0x780 0x780 0x780 0x780 0x780 0x780 0x780 0x780 0x780 0x780 0x780 0x780 0x780 0x780 0x780 0x780 0x780 0x780 0x780 0x780 0x780 0x780 0x780 0x780 0x780 0x780 0x780 0x780 0x780 0x780 0x780 0x780 0x780 0x780 0x780 0x780 0x780 0x780 0x780 0x780 0x780 0x780 0x780 0x780 0x780 0x780 0x780 0x780 0x780 0x780 0x780 0x780 0x780 0x780 0x780 0x780 0x780 0x780 0x780 0x780 0x780 0x780 0x780 0x780 0x780 0x780 0x780 0x780 0x780 0x780 0x780 0x780 0x780 0x780 0x780 0x780 0x780 0x780 0x780 0x780 0x780 0x780 0x780 0x780 0x780 0x780 0x780 0x780 0x780 0x780 0x780 0x780 0x780 0x780 0x780 0x780 0x780 0x780 0x780 0x780 0x780 0x780 0x780 0x780 0x780 0x780 0x780 0x780 0x780 0x780 0x780 0x780 0x780 0x780 0x780 0x780 0x780 0x780 0x780 0x780 0x780 0x780 0x780 0x780 0x780 0x780 0x780 0x780 0x780 0x780 0x780 0x780 0x780 0x780 0x780 0x780 0x780 0x780 0x780 0x780 0x780 0x780 0x780 0x780 0x780 0x780 0x780 0x780 0x780 0x780 0x780 0x780 0x780 0x780 0x780 0x780 0x780 0x780 0x780 0x780 0x780 0x780 0x780 0x780 0x780 0x780 0x780 0x780 0x780 0x780 0x780 0x780 0x780 0x780 0x780 0x780 0x780 0x780 0x780 0x780 0x780 0x780 0x780 0x780 0x780 0x780 0x780 0x780 0x780 0x780 0x780 0x780 0x780 0x780 0x780 0x780 0x780 0x780 0x780 0x780 0x780 0x780 0x780 0x780 0x780 0x780 0x780 0x780 0x780 0x780 0x780 0x780 0x780 0x780 0x780 0x780 0x780 0x780 0x780 0x780 0x780 0x780 0x780 0x780 0x780 0x780 0x780 0x780 0x780 0x780 0x780 0x780 0x780 0x780 0x780 0x780 0x780 0x780 0x780 0x780 0x780 0x780 0x780 0x780 0x780 0x780 0x780 0x780 0x780 0x780 0x780 0x780 0x780 0x780 0x780 0x780 0x780 0x780 0x780 0x780 0x780 0x780 0x780 0x780 0x780 0x780 0x780 0x780 0x780 0x780 0x780 0x780 0x780 0x780 0x780 0x780 0x780 0x780 0x780 0x780 0x780 0x780 0x780 0x780 0x780 0x780 0x780 0x780 0x780 0x780 0x780 0x780 0x780 0x780 0x780 0x780 0x780 0x780 0x780 0x780 0x780 0x780 0x780 0x780 0x780 0x780 0x780 0x780 0x780 0x780 0x780 0x780 0x780 0x780 0x780 0x780 0x780 0x780 0x780 0x780 0x780 0x780 0x780 0x780 0x780 0x780 0x780 0x780 0x780 0x780 0x780 0x780 0x780 0x780 0x780 0x780 0x780 0x780 0x780 0x780 0x780 0x780 0x780 0x780 0x780 0x780 0x780 0x780 0x780 0x780 0x780 0x780 0x780 0x780 0x780 0x780 0x780 0x780 0x780 0x780 0x780 0x780 0x780 0x780 0x780 0x780 0x780 0x780 0x780 0x780 0x780 0x780 0x780 0x780 0x780 0x780 0x780 0x780 0x780 0x780 0x780 0x780 0x780 0x780 0x780 0x780 0x780 0x780 0x780 0x780 0x780 0x780 0x780 0x780 0x780 0x780 0x780 0x780 0x780 0x780 0x780 0x780 0x780 0x780 0x780 0x780 0x780 0x780 0x780 0x780 0x780 0x780 0x780 0x780 0x780 0x780 0x780 0x780 0x780 0x780 0x780 0x780 0x780 0x780 0x780 0x780 0x780 0x780 0x780 0x780 0x780 0x780 0x780 0x780 0x780 0x780 0x780 0x780 0x780 0x780 0x780 0x780 0x780 0x780 0x780 0x780 0x780 0x780 0x780 0x780 0x780 0x780 0x780 0x780 0x780 0x780 0x780 0x780 0x780 0x780 0x780 0x780 0x780 0x780 0x780 0x780 0x780 0x780 0x780 0x780 0x780 0x780 0x780 0x780 0x780 0x780 0x780 0x780 0x780 0x780 0x780 0x780 0x780 0x780 0x780 0x780 0x780 0x780 0x780 0x780 0x780 0x780 0x780 0x780 0x780 0x780 0x780 0x780 0x780 0x780 0x780 0x780 0x780 0x780 0x780 0x780 0x780 0x780 0x780 0x780 0x780 0x780 0x780 0x780 0x780 0x780 0x780 0x780 0x780 0x780 0x780 0x780 0x780 0x780 0x780 0x780 0x780 0x780 0x780 0x780 0x780 0x780 0x780 0x780 0x780 0x780 0x780 0x780 0x780 0x780 0x780 0x780 0x780 0x780 0x780 0x780 0x780 0x780 0x780 0x780 0x780 0x780 0x780 0x780 0x780 0x780 0x780 0x780 0x780 0x780 0x780 0x780 0x780 0x780 0x780 0x780 0x780 0x780 0x780 0x780 0x780 0x780 0x780 0x780 0x780 0x780 0x780 0x780>;
				PS_Config_Lmt_FW_Rawdata_N = <0xf0 0xf0 0xf0 0xf0 0xf0 0xf0 0xf0 0xf0 0xf0 0xf0 0xf0 0xf0 0xf0 0xf0 0xf0 0xf0 0xf0 0xf0 0xf0 0xf0 0xf0 0xf0 0xf0 0xf0 0xf0 0xf0 0xf0 0xf0 0xf0 0xf0 0xf0 0xf0 0xf0 0xf0 0xf0 0xf0 0xf0 0xf0 0xf0 0xf0 0xf0 0xf0 0xf0 0xf0 0xf0 0xf0 0xf0 0xf0 0xf0 0xf0 0xf0 0xf0 0xf0 0xf0 0xf0 0xf0 0xf0 0xf0 0xf0 0xf0 0xf0 0xf0 0xf0 0xf0 0xf0 0xf0 0xf0 0xf0 0xf0 0xf0 0xf0 0xf0 0xf0 0xf0 0xf0 0xf0 0xf0 0xf0 0xf0 0xf0 0xf0 0xf0 0xf0 0xf0 0xf0 0xf0 0xf0 0xf0 0xf0 0xf0 0xf0 0xf0 0xf0 0xf0 0xf0 0xf0 0xf0 0xf0 0xf0 0xf0 0xf0 0xf0 0xf0 0xf0 0xf0 0xf0 0xf0 0xf0 0xf0 0xf0 0xf0 0xf0 0xf0 0xf0 0xf0 0xf0 0xf0 0xf0 0xf0 0xf0 0xf0 0xf0 0xf0 0xf0 0xf0 0xf0 0xf0 0xf0 0xf0 0xf0 0xf0 0xf0 0xf0 0xf0 0xf0 0xf0 0xf0 0xf0 0xf0 0xf0 0xf0 0xf0 0xf0 0xf0 0xf0 0xf0 0xf0 0xf0 0xf0 0xf0 0xf0 0xf0 0xf0 0xf0 0xf0 0xf0 0xf0 0xf0 0xf0 0xf0 0xf0 0xf0 0xf0 0xf0 0xf0 0xf0 0xf0 0xf0 0xf0 0xf0 0xf0 0xf0 0xf0 0xf0 0xf0 0xf0 0xf0 0xf0 0xf0 0xf0 0xf0 0xf0 0xf0 0xf0 0xf0 0xf0 0xf0 0xf0 0xf0 0xf0 0xf0 0xf0 0xf0 0xf0 0xf0 0xf0 0xf0 0xf0 0xf0 0xf0 0xf0 0xf0 0xf0 0xf0 0xf0 0xf0 0xf0 0xf0 0xf0 0xf0 0xf0 0xf0 0xf0 0xf0 0xf0 0xf0 0xf0 0xf0 0xf0 0xf0 0xf0 0xf0 0xf0 0xf0 0xf0 0xf0 0xf0 0xf0 0xf0 0xf0 0xf0 0xf0 0xf0 0xf0 0xf0 0xf0 0xf0 0xf0 0xf0 0xf0 0xf0 0xf0 0xf0 0xf0 0xf0 0xf0 0xf0 0xf0 0xf0 0xf0 0xf0 0xf0 0xf0 0xf0 0xf0 0xf0 0xf0 0xf0 0xf0 0xf0 0xf0 0xf0 0xf0 0xf0 0xf0 0xf0 0xf0 0xf0 0xf0 0xf0 0xf0 0xf0 0xf0 0xf0 0xf0 0xf0 0xf0 0xf0 0xf0 0xf0 0xf0 0xf0 0xf0 0xf0 0xf0 0xf0 0xf0 0xf0 0xf0 0xf0 0xf0 0xf0 0xf0 0xf0 0xf0 0xf0 0xf0 0xf0 0xf0 0xf0 0xf0 0xf0 0xf0 0xf0 0xf0 0xf0 0xf0 0xf0 0xf0 0xf0 0xf0 0xf0 0xf0 0xf0 0xf0 0xf0 0xf0 0xf0 0xf0 0xf0 0xf0 0xf0 0xf0 0xf0 0xf0 0xf0 0xf0 0xf0 0xf0 0xf0 0xf0 0xf0 0xf0 0xf0 0xf0 0xf0 0xf0 0xf0 0xf0 0xf0 0xf0 0xf0 0xf0 0xf0 0xf0 0xf0 0xf0 0xf0 0xf0 0xf0 0xf0 0xf0 0xf0 0xf0 0xf0 0xf0 0xf0 0xf0 0xf0 0xf0 0xf0 0xf0 0xf0 0xf0 0xf0 0xf0 0xf0 0xf0 0xf0 0xf0 0xf0 0xf0 0xf0 0xf0 0xf0 0xf0 0xf0 0xf0 0xf0 0xf0 0xf0 0xf0 0xf0 0xf0 0xf0 0xf0 0xf0 0xf0 0xf0 0xf0 0xf0 0xf0 0xf0 0xf0 0xf0 0xf0 0xf0 0xf0 0xf0 0xf0 0xf0 0xf0 0xf0 0xf0 0xf0 0xf0 0xf0 0xf0 0xf0 0xf0 0xf0 0xf0 0xf0 0xf0 0xf0 0xf0 0xf0 0xf0 0xf0 0xf0 0xf0 0xf0 0xf0 0xf0 0xf0 0xf0 0xf0 0xf0 0xf0 0xf0 0xf0 0xf0 0xf0 0xf0 0xf0 0xf0 0xf0 0xf0 0xf0 0xf0 0xf0 0xf0 0xf0 0xf0 0xf0 0xf0 0xf0 0xf0 0xf0 0xf0 0xf0 0xf0 0xf0 0xf0 0xf0 0xf0 0xf0 0xf0 0xf0 0xf0 0xf0 0xf0 0xf0 0xf0 0xf0 0xf0 0xf0 0xf0 0xf0 0xf0 0xf0 0xf0 0xf0 0xf0 0xf0 0xf0 0xf0 0xf0 0xf0 0xf0 0xf0 0xf0 0xf0 0xf0 0xf0 0xf0 0xf0 0xf0 0xf0 0xf0 0xf0 0xf0 0xf0 0xf0 0xf0 0xf0 0xf0 0xf0 0xf0 0xf0 0xf0 0xf0 0xf0 0xf0 0xf0 0xf0 0xf0 0xf0 0xf0 0xf0 0xf0 0xf0 0xf0 0xf0 0xf0 0xf0 0xf0 0xf0 0xf0 0xf0 0xf0 0xf0 0xf0 0xf0 0xf0 0xf0 0xf0 0xf0 0xf0 0xf0 0xf0 0xf0 0xf0 0xf0 0xf0 0xf0 0xf0 0xf0 0xf0 0xf0 0xf0 0xf0 0xf0 0xf0 0xf0 0xf0 0xf0 0xf0 0xf0 0xf0 0xf0 0xf0 0xf0 0xf0 0xf0 0xf0 0xf0 0xf0 0xf0 0xf0 0xf0 0xf0 0xf0 0xf0 0xf0 0xf0 0xf0 0xf0 0xf0 0xf0 0xf0 0xf0 0xf0 0xf0 0xf0 0xf0 0xf0 0xf0 0xf0 0xf0 0xf0 0xf0 0xf0 0xf0 0xf0 0xf0 0xf0 0xf0 0xf0 0xf0 0xf0 0xf0 0xf0 0xf0 0xf0 0xf0 0xf0 0xf0 0xf0 0xf0 0xf0 0xf0 0xf0 0xf0 0xf0 0xf0 0xf0 0xf0 0xf0 0xf0 0xf0 0xf0 0xf0 0xf0 0xf0 0xf0 0xf0 0xf0 0xf0 0xf0 0xf0 0xf0 0xf0 0xf0 0xf0 0xf0 0xf0 0xf0 0xf0 0xf0 0xf0 0xf0 0xf0 0xf0 0xf0 0xf0 0xf0 0xf0 0xf0 0xf0 0xf0 0xf0 0xf0 0xf0 0xf0 0xf0 0xf0 0xf0 0xf0 0xf0 0xf0>;
				PS_Config_Lmt_FW_CC_P = <0x13a 0x13a 0x13a 0x13a 0x13a 0x13a 0x13a 0x13a 0x13a 0x13a 0x13a 0x13a 0x13a 0x13a 0x13a 0x13a 0x13a 0x13a 0x13a 0x13a 0x13a 0x13a 0x13a 0x13a 0x13a 0x13a 0x13a 0x13a 0x13a 0x13a 0x13a 0x13a 0x13a 0x13a 0x13a 0x13a 0x13a 0x13a 0x13a 0x13a 0x13a 0x13a 0x13a 0x13a 0x13a 0x13a 0x13a 0x13a 0x13a 0x13a 0x13a 0x13a 0x13a 0x13a 0x13a 0x13a 0x13a 0x13a 0x13a 0x13a 0x13a 0x13a 0x13a 0x13a 0x13a 0x13a 0x13a 0x13a 0x13a 0x13a 0x13a 0x13a 0x13a 0x13a 0x13a 0x13a 0x13a 0x13a 0x13a 0x13a 0x13a 0x13a 0x13a 0x13a 0x13a 0x13a 0x13a 0x13a 0x13a 0x13a 0x13a 0x13a 0x13a 0x13a 0x13a 0x13a 0x13a 0x13a 0x13a 0x13a 0x13a 0x13a 0x13a 0x13a 0x13a 0x13a 0x13a 0x13a 0x13a 0x13a 0x13a 0x13a 0x13a 0x13a 0x13a 0x13a 0x13a 0x13a 0x13a 0x13a 0x13a 0x13a 0x13a 0x13a 0x13a 0x13a 0x13a 0x13a 0x13a 0x13a 0x13a 0x13a 0x13a 0x13a 0x13a 0x13a 0x13a 0x13a 0x13a 0x13a 0x13a 0x13a 0x13a 0x13a 0x13a 0x13a 0x13a 0x13a 0x13a 0x13a 0x13a 0x13a 0x13a 0x13a 0x13a 0x13a 0x13a 0x13a 0x13a 0x13a 0x13a 0x13a 0x13a 0x13a 0x13a 0x13a 0x13a 0x13a 0x13a 0x13a 0x13a 0x13a 0x13a 0x13a 0x13a 0x13a 0x13a 0x13a 0x13a 0x13a 0x13a 0x13a 0x13a 0x13a 0x13a 0x13a 0x13a 0x13a 0x13a 0x13a 0x13a 0x13a 0x13a 0x13a 0x13a 0x13a 0x13a 0x13a 0x13a 0x13a 0x13a 0x13a 0x13a 0x13a 0x13a 0x13a 0x13a 0x13a 0x13a 0x13a 0x13a 0x13a 0x13a 0x13a 0x13a 0x13a 0x13a 0x13a 0x13a 0x13a 0x13a 0x13a 0x13a 0x13a 0x13a 0x13a 0x13a 0x13a 0x13a 0x13a 0x13a 0x13a 0x13a 0x13a 0x13a 0x13a 0x13a 0x13a 0x13a 0x13a 0x13a 0x13a 0x13a 0x13a 0x13a 0x13a 0x13a 0x13a 0x13a 0x13a 0x13a 0x13a 0x13a 0x13a 0x13a 0x13a 0x13a 0x13a 0x13a 0x13a 0x13a 0x13a 0x13a 0x13a 0x13a 0x13a 0x13a 0x13a 0x13a 0x13a 0x13a 0x13a 0x13a 0x13a 0x13a 0x13a 0x13a 0x13a 0x13a 0x13a 0x13a 0x13a 0x13a 0x13a 0x13a 0x13a 0x13a 0x13a 0x13a 0x13a 0x13a 0x13a 0x13a 0x13a 0x13a 0x13a 0x13a 0x13a 0x13a 0x13a 0x13a 0x13a 0x13a 0x13a 0x13a 0x13a 0x13a 0x13a 0x13a 0x13a 0x13a 0x13a 0x13a 0x13a 0x13a 0x13a 0x13a 0x13a 0x13a 0x13a 0x13a 0x13a 0x13a 0x13a 0x13a 0x13a 0x13a 0x13a 0x13a 0x13a 0x13a 0x13a 0x13a 0x13a 0x13a 0x13a 0x13a 0x13a 0x13a 0x13a 0x13a 0x13a 0x13a 0x13a 0x13a 0x13a 0x13a 0x13a 0x13a 0x13a 0x13a 0x13a 0x13a 0x13a 0x13a 0x13a 0x13a 0x13a 0x13a 0x13a 0x13a 0x13a 0x13a 0x13a 0x13a 0x13a 0x13a 0x13a 0x13a 0x13a 0x13a 0x13a 0x13a 0x13a 0x13a 0x13a 0x13a 0x13a 0x13a 0x13a 0x13a 0x13a 0x13a 0x13a 0x13a 0x13a 0x13a 0x13a 0x13a 0x13a 0x13a 0x13a 0x13a 0x13a 0x13a 0x13a 0x13a 0x13a 0x13a 0x13a 0x13a 0x13a 0x13a 0x13a 0x13a 0x13a 0x13a 0x13a 0x13a 0x13a 0x13a 0x13a 0x13a 0x13a 0x13a 0x13a 0x13a 0x13a 0x13a 0x13a 0x13a 0x13a 0x13a 0x13a 0x13a 0x13a 0x13a 0x13a 0x13a 0x13a 0x13a 0x13a 0x13a 0x13a 0x13a 0x13a 0x13a 0x13a 0x13a 0x13a 0x13a 0x13a 0x13a 0x13a 0x13a 0x13a 0x13a 0x13a 0x13a 0x13a 0x13a 0x13a 0x13a 0x13a 0x13a 0x13a 0x13a 0x13a 0x13a 0x13a 0x13a 0x13a 0x13a 0x13a 0x13a 0x13a 0x13a 0x13a 0x13a 0x13a 0x13a 0x13a 0x13a 0x13a 0x13a 0x13a 0x13a 0x13a 0x13a 0x13a 0x13a 0x13a 0x13a 0x13a 0x13a 0x13a 0x13a 0x13a 0x13a 0x13a 0x13a 0x13a 0x13a 0x13a 0x13a 0x13a 0x13a 0x13a 0x13a 0x13a 0x13a 0x13a 0x13a 0x13a 0x13a 0x13a 0x13a 0x13a 0x13a 0x13a 0x13a 0x13a 0x13a 0x13a 0x13a 0x13a 0x13a 0x13a 0x13a 0x13a 0x13a 0x13a 0x13a 0x13a 0x13a 0x13a 0x13a 0x13a 0x13a 0x13a 0x13a 0x13a 0x13a 0x13a 0x13a 0x13a 0x13a 0x13a 0x13a 0x13a 0x13a 0x13a 0x13a 0x13a 0x13a 0x13a 0x13a 0x13a 0x13a 0x13a 0x13a 0x13a 0x13a 0x13a 0x13a 0x13a 0x13a 0x13a 0x13a 0x13a 0x13a 0x13a 0x13a 0x13a 0x13a 0x13a 0x13a 0x13a 0x13a 0x13a 0x13a 0x13a 0x13a 0x13a 0x13a 0x13a 0x13a 0x13a 0x13a 0x13a 0x13a 0x13a 0x13a 0x13a 0x13a 0x13a 0x13a 0x13a 0x13a 0x13a 0x13a 0x13a 0x13a 0x13a 0x13a 0x13a 0x13a 0x13a 0x13a 0x13a 0x13a 0x13a 0x13a 0x13a 0x13a 0x13a 0x13a 0x13a 0x13a 0x13a 0x13a 0x13a 0x13a 0x13a 0x13a 0x13a 0x13a 0x13a 0x13a 0x13a 0x13a 0x13a 0x13a 0x13a 0x13a 0x13a 0x13a 0x13a 0x13a 0x13a 0x13a 0x13a 0x13a 0x13a 0x13a 0x13a 0x13a 0x13a 0x13a 0x13a 0x13a 0x13a 0x13a 0x13a 0x13a 0x13a 0x13a 0x13a 0x13a 0x13a 0x13a>;
				PS_Config_Lmt_FW_CC_N = <0x1e 0x1e 0x1e 0x1e 0x1e 0x1e 0x1e 0x1e 0x1e 0x1e 0x1e 0x1e 0x1e 0x1e 0x1e 0x1e 0x1e 0x1e 0x1e 0x1e 0x1e 0x1e 0x1e 0x1e 0x1e 0x1e 0x1e 0x1e 0x1e 0x1e 0x1e 0x1e 0x1e 0x1e 0x1e 0x1e 0x1e 0x1e 0x1e 0x1e 0x1e 0x1e 0x1e 0x1e 0x1e 0x1e 0x1e 0x1e 0x1e 0x1e 0x1e 0x1e 0x1e 0x1e 0x1e 0x1e 0x1e 0x1e 0x1e 0x1e 0x1e 0x1e 0x1e 0x1e 0x1e 0x1e 0x1e 0x1e 0x1e 0x1e 0x1e 0x1e 0x1e 0x1e 0x1e 0x1e 0x1e 0x1e 0x1e 0x1e 0x1e 0x1e 0x1e 0x1e 0x1e 0x1e 0x1e 0x1e 0x1e 0x1e 0x1e 0x1e 0x1e 0x1e 0x1e 0x1e 0x1e 0x1e 0x1e 0x1e 0x1e 0x1e 0x1e 0x1e 0x1e 0x1e 0x1e 0x1e 0x1e 0x1e 0x1e 0x1e 0x1e 0x1e 0x1e 0x1e 0x1e 0x1e 0x1e 0x1e 0x1e 0x1e 0x1e 0x1e 0x1e 0x1e 0x1e 0x1e 0x1e 0x1e 0x1e 0x1e 0x1e 0x1e 0x1e 0x1e 0x1e 0x1e 0x1e 0x1e 0x1e 0x1e 0x1e 0x1e 0x1e 0x1e 0x1e 0x1e 0x1e 0x1e 0x1e 0x1e 0x1e 0x1e 0x1e 0x1e 0x1e 0x1e 0x1e 0x1e 0x1e 0x1e 0x1e 0x1e 0x1e 0x1e 0x1e 0x1e 0x1e 0x1e 0x1e 0x1e 0x1e 0x1e 0x1e 0x1e 0x1e 0x1e 0x1e 0x1e 0x1e 0x1e 0x1e 0x1e 0x1e 0x1e 0x1e 0x1e 0x1e 0x1e 0x1e 0x1e 0x1e 0x1e 0x1e 0x1e 0x1e 0x1e 0x1e 0x1e 0x1e 0x1e 0x1e 0x1e 0x1e 0x1e 0x1e 0x1e 0x1e 0x1e 0x1e 0x1e 0x1e 0x1e 0x1e 0x1e 0x1e 0x1e 0x1e 0x1e 0x1e 0x1e 0x1e 0x1e 0x1e 0x1e 0x1e 0x1e 0x1e 0x1e 0x1e 0x1e 0x1e 0x1e 0x1e 0x1e 0x1e 0x1e 0x1e 0x1e 0x1e 0x1e 0x1e 0x1e 0x1e 0x1e 0x1e 0x1e 0x1e 0x1e 0x1e 0x1e 0x1e 0x1e 0x1e 0x1e 0x1e 0x1e 0x1e 0x1e 0x1e 0x1e 0x1e 0x1e 0x1e 0x1e 0x1e 0x1e 0x1e 0x1e 0x1e 0x1e 0x1e 0x1e 0x1e 0x1e 0x1e 0x1e 0x1e 0x1e 0x1e 0x1e 0x1e 0x1e 0x1e 0x1e 0x1e 0x1e 0x1e 0x1e 0x1e 0x1e 0x1e 0x1e 0x1e 0x1e 0x1e 0x1e 0x1e 0x1e 0x1e 0x1e 0x1e 0x1e 0x1e 0x1e 0x1e 0x1e 0x1e 0x1e 0x1e 0x1e 0x1e 0x1e 0x1e 0x1e 0x1e 0x1e 0x1e 0x1e 0x1e 0x1e 0x1e 0x1e 0x1e 0x1e 0x1e 0x1e 0x1e 0x1e 0x1e 0x1e 0x1e 0x1e 0x1e 0x1e 0x1e 0x1e 0x1e 0x1e 0x1e 0x1e 0x1e 0x1e 0x1e 0x1e 0x1e 0x1e 0x1e 0x1e 0x1e 0x1e 0x1e 0x1e 0x1e 0x1e 0x1e 0x1e 0x1e 0x1e 0x1e 0x1e 0x1e 0x1e 0x1e 0x1e 0x1e 0x1e 0x1e 0x1e 0x1e 0x1e 0x1e 0x1e 0x1e 0x1e 0x1e 0x1e 0x1e 0x1e 0x1e 0x1e 0x1e 0x1e 0x1e 0x1e 0x1e 0x1e 0x1e 0x1e 0x1e 0x1e 0x1e 0x1e 0x1e 0x1e 0x1e 0x1e 0x1e 0x1e 0x1e 0x1e 0x1e 0x1e 0x1e 0x1e 0x1e 0x1e 0x1e 0x1e 0x1e 0x1e 0x1e 0x1e 0x1e 0x1e 0x1e 0x1e 0x1e 0x1e 0x1e 0x1e 0x1e 0x1e 0x1e 0x1e 0x1e 0x1e 0x1e 0x1e 0x1e 0x1e 0x1e 0x1e 0x1e 0x1e 0x1e 0x1e 0x1e 0x1e 0x1e 0x1e 0x1e 0x1e 0x1e 0x1e 0x1e 0x1e 0x1e 0x1e 0x1e 0x1e 0x1e 0x1e 0x1e 0x1e 0x1e 0x1e 0x1e 0x1e 0x1e 0x1e 0x1e 0x1e 0x1e 0x1e 0x1e 0x1e 0x1e 0x1e 0x1e 0x1e 0x1e 0x1e 0x1e 0x1e 0x1e 0x1e 0x1e 0x1e 0x1e 0x1e 0x1e 0x1e 0x1e 0x1e 0x1e 0x1e 0x1e 0x1e 0x1e 0x1e 0x1e 0x1e 0x1e 0x1e 0x1e 0x1e 0x1e 0x1e 0x1e 0x1e 0x1e 0x1e 0x1e 0x1e 0x1e 0x1e 0x1e 0x1e 0x1e 0x1e 0x1e 0x1e 0x1e 0x1e 0x1e 0x1e 0x1e 0x1e 0x1e 0x1e 0x1e 0x1e 0x1e 0x1e 0x1e 0x1e 0x1e 0x1e 0x1e 0x1e 0x1e 0x1e 0x1e 0x1e 0x1e 0x1e 0x1e 0x1e 0x1e 0x1e 0x1e 0x1e 0x1e 0x1e 0x1e 0x1e 0x1e 0x1e 0x1e 0x1e 0x1e 0x1e 0x1e 0x1e 0x1e 0x1e 0x1e 0x1e 0x1e 0x1e 0x1e 0x1e 0x1e 0x1e 0x1e 0x1e 0x1e 0x1e 0x1e 0x1e 0x1e 0x1e 0x1e 0x1e 0x1e 0x1e 0x1e 0x1e 0x1e 0x1e 0x1e 0x1e 0x1e 0x1e 0x1e 0x1e 0x1e 0x1e 0x1e 0x1e 0x1e 0x1e 0x1e 0x1e 0x1e 0x1e 0x1e 0x1e 0x1e 0x1e 0x1e 0x1e 0x1e 0x1e 0x1e 0x1e 0x1e 0x1e 0x1e 0x1e 0x1e 0x1e 0x1e 0x1e 0x1e 0x1e 0x1e 0x1e 0x1e 0x1e 0x1e 0x1e 0x1e 0x1e 0x1e 0x1e 0x1e 0x1e 0x1e 0x1e 0x1e 0x1e 0x1e 0x1e 0x1e 0x1e 0x1e 0x1e 0x1e 0x1e 0x1e 0x1e 0x1e 0x1e 0x1e 0x1e 0x1e 0x1e 0x1e>;
				PS_Config_Lmt_FW_Diff_P = <0x4b 0x4b 0x4b 0x4b 0x4b 0x4b 0x4b 0x4b 0x4b 0x4b 0x4b 0x4b 0x4b 0x4b 0x4b 0x4b 0x4b 0x4b 0x4b 0x4b 0x4b 0x4b 0x4b 0x4b 0x4b 0x4b 0x4b 0x4b 0x4b 0x4b 0x4b 0x4b 0x4b 0x4b 0x4b 0x4b 0x4b 0x4b 0x4b 0x4b 0x4b 0x4b 0x4b 0x4b 0x4b 0x4b 0x4b 0x4b 0x4b 0x4b 0x4b 0x4b 0x4b 0x4b 0x4b 0x4b 0x4b 0x4b 0x4b 0x4b 0x4b 0x4b 0x4b 0x4b 0x4b 0x4b 0x4b 0x4b 0x4b 0x4b 0x4b 0x4b 0x4b 0x4b 0x4b 0x4b 0x4b 0x4b 0x4b 0x4b 0x4b 0x4b 0x4b 0x4b 0x4b 0x4b 0x4b 0x4b 0x4b 0x4b 0x4b 0x4b 0x4b 0x4b 0x4b 0x4b 0x4b 0x4b 0x4b 0x4b 0x4b 0x4b 0x4b 0x4b 0x4b 0x4b 0x4b 0x4b 0x4b 0x4b 0x4b 0x4b 0x4b 0x4b 0x4b 0x4b 0x4b 0x4b 0x4b 0x4b 0x4b 0x4b 0x4b 0x4b 0x4b 0x4b 0x4b 0x4b 0x4b 0x4b 0x4b 0x4b 0x4b 0x4b 0x4b 0x4b 0x4b 0x4b 0x4b 0x4b 0x4b 0x4b 0x4b 0x4b 0x4b 0x4b 0x4b 0x4b 0x4b 0x4b 0x4b 0x4b 0x4b 0x4b 0x4b 0x4b 0x4b 0x4b 0x4b 0x4b 0x4b 0x4b 0x4b 0x4b 0x4b 0x4b 0x4b 0x4b 0x4b 0x4b 0x4b 0x4b 0x4b 0x4b 0x4b 0x4b 0x4b 0x4b 0x4b 0x4b 0x4b 0x4b 0x4b 0x4b 0x4b 0x4b 0x4b 0x4b 0x4b 0x4b 0x4b 0x4b 0x4b 0x4b 0x4b 0x4b 0x4b 0x4b 0x4b 0x4b 0x4b 0x4b 0x4b 0x4b 0x4b 0x4b 0x4b 0x4b 0x4b 0x4b 0x4b 0x4b 0x4b 0x4b 0x4b 0x4b 0x4b 0x4b 0x4b 0x4b 0x4b 0x4b 0x4b 0x4b 0x4b 0x4b 0x4b 0x4b 0x4b 0x4b 0x4b 0x4b 0x4b 0x4b 0x4b 0x4b 0x4b 0x4b 0x4b 0x4b 0x4b 0x4b 0x4b 0x4b 0x4b 0x4b 0x4b 0x4b 0x4b 0x4b 0x4b 0x4b 0x4b 0x4b 0x4b 0x4b 0x4b 0x4b 0x4b 0x4b 0x4b 0x4b 0x4b 0x4b 0x4b 0x4b 0x4b 0x4b 0x4b 0x4b 0x4b 0x4b 0x4b 0x4b 0x4b 0x4b 0x4b 0x4b 0x4b 0x4b 0x4b 0x4b 0x4b 0x4b 0x4b 0x4b 0x4b 0x4b 0x4b 0x4b 0x4b 0x4b 0x4b 0x4b 0x4b 0x4b 0x4b 0x4b 0x4b 0x4b 0x4b 0x4b 0x4b 0x4b 0x4b 0x4b 0x4b 0x4b 0x4b 0x4b 0x4b 0x4b 0x4b 0x4b 0x4b 0x4b 0x4b 0x4b 0x4b 0x4b 0x4b 0x4b 0x4b 0x4b 0x4b 0x4b 0x4b 0x4b 0x4b 0x4b 0x4b 0x4b 0x4b 0x4b 0x4b 0x4b 0x4b 0x4b 0x4b 0x4b 0x4b 0x4b 0x4b 0x4b 0x4b 0x4b 0x4b 0x4b 0x4b 0x4b 0x4b 0x4b 0x4b 0x4b 0x4b 0x4b 0x4b 0x4b 0x4b 0x4b 0x4b 0x4b 0x4b 0x4b 0x4b 0x4b 0x4b 0x4b 0x4b 0x4b 0x4b 0x4b 0x4b 0x4b 0x4b 0x4b 0x4b 0x4b 0x4b 0x4b 0x4b 0x4b 0x4b 0x4b 0x4b 0x4b 0x4b 0x4b 0x4b 0x4b 0x4b 0x4b 0x4b 0x4b 0x4b 0x4b 0x4b 0x4b 0x4b 0x4b 0x4b 0x4b 0x4b 0x4b 0x4b 0x4b 0x4b 0x4b 0x4b 0x4b 0x4b 0x4b 0x4b 0x4b 0x4b 0x4b 0x4b 0x4b 0x4b 0x4b 0x4b 0x4b 0x4b 0x4b 0x4b 0x4b 0x4b 0x4b 0x4b 0x4b 0x4b 0x4b 0x4b 0x4b 0x4b 0x4b 0x4b 0x4b 0x4b 0x4b 0x4b 0x4b 0x4b 0x4b 0x4b 0x4b 0x4b 0x4b 0x4b 0x4b 0x4b 0x4b 0x4b 0x4b 0x4b 0x4b 0x4b 0x4b 0x4b 0x4b 0x4b 0x4b 0x4b 0x4b 0x4b 0x4b 0x4b 0x4b 0x4b 0x4b 0x4b 0x4b 0x4b 0x4b 0x4b 0x4b 0x4b 0x4b 0x4b 0x4b 0x4b 0x4b 0x4b 0x4b 0x4b 0x4b 0x4b 0x4b 0x4b 0x4b 0x4b 0x4b 0x4b 0x4b 0x4b 0x4b 0x4b 0x4b 0x4b 0x4b 0x4b 0x4b 0x4b 0x4b 0x4b 0x4b 0x4b 0x4b 0x4b 0x4b 0x4b 0x4b 0x4b 0x4b 0x4b 0x4b 0x4b 0x4b 0x4b 0x4b 0x4b 0x4b 0x4b 0x4b 0x4b 0x4b 0x4b 0x4b 0x4b 0x4b 0x4b 0x4b 0x4b 0x4b 0x4b 0x4b 0x4b 0x4b 0x4b 0x4b 0x4b 0x4b 0x4b 0x4b 0x4b 0x4b 0x4b 0x4b 0x4b 0x4b 0x4b 0x4b 0x4b 0x4b 0x4b 0x4b 0x4b 0x4b 0x4b 0x4b 0x4b 0x4b 0x4b 0x4b 0x4b 0x4b 0x4b 0x4b 0x4b 0x4b 0x4b 0x4b 0x4b 0x4b 0x4b 0x4b 0x4b 0x4b 0x4b 0x4b 0x4b 0x4b 0x4b 0x4b 0x4b 0x4b 0x4b 0x4b 0x4b 0x4b 0x4b 0x4b 0x4b 0x4b 0x4b 0x4b 0x4b 0x4b 0x4b 0x4b 0x4b 0x4b 0x4b 0x4b 0x4b 0x4b 0x4b 0x4b 0x4b 0x4b 0x4b 0x4b 0x4b 0x4b 0x4b 0x4b 0x4b 0x4b 0x4b 0x4b 0x4b 0x4b 0x4b 0x4b 0x4b 0x4b 0x4b 0x4b 0x4b 0x4b 0x4b 0x4b 0x4b 0x4b 0x4b 0x4b 0x4b 0x4b 0x4b 0x4b 0x4b 0x4b 0x4b 0x4b 0x4b 0x4b 0x4b 0x4b 0x4b 0x4b 0x4b>;
				PS_Config_Lmt_FW_Diff_N = <0xffffffb5 0xffffffb5 0xffffffb5 0xffffffb5 0xffffffb5 0xffffffb5 0xffffffb5 0xffffffb5 0xffffffb5 0xffffffb5 0xffffffb5 0xffffffb5 0xffffffb5 0xffffffb5 0xffffffb5 0xffffffb5 0xffffffb5 0xffffffb5 0xffffffb5 0xffffffb5 0xffffffb5 0xffffffb5 0xffffffb5 0xffffffb5 0xffffffb5 0xffffffb5 0xffffffb5 0xffffffb5 0xffffffb5 0xffffffb5 0xffffffb5 0xffffffb5 0xffffffb5 0xffffffb5 0xffffffb5 0xffffffb5 0xffffffb5 0xffffffb5 0xffffffb5 0xffffffb5 0xffffffb5 0xffffffb5 0xffffffb5 0xffffffb5 0xffffffb5 0xffffffb5 0xffffffb5 0xffffffb5 0xffffffb5 0xffffffb5 0xffffffb5 0xffffffb5 0xffffffb5 0xffffffb5 0xffffffb5 0xffffffb5 0xffffffb5 0xffffffb5 0xffffffb5 0xffffffb5 0xffffffb5 0xffffffb5 0xffffffb5 0xffffffb5 0xffffffb5 0xffffffb5 0xffffffb5 0xffffffb5 0xffffffb5 0xffffffb5 0xffffffb5 0xffffffb5 0xffffffb5 0xffffffb5 0xffffffb5 0xffffffb5 0xffffffb5 0xffffffb5 0xffffffb5 0xffffffb5 0xffffffb5 0xffffffb5 0xffffffb5 0xffffffb5 0xffffffb5 0xffffffb5 0xffffffb5 0xffffffb5 0xffffffb5 0xffffffb5 0xffffffb5 0xffffffb5 0xffffffb5 0xffffffb5 0xffffffb5 0xffffffb5 0xffffffb5 0xffffffb5 0xffffffb5 0xffffffb5 0xffffffb5 0xffffffb5 0xffffffb5 0xffffffb5 0xffffffb5 0xffffffb5 0xffffffb5 0xffffffb5 0xffffffb5 0xffffffb5 0xffffffb5 0xffffffb5 0xffffffb5 0xffffffb5 0xffffffb5 0xffffffb5 0xffffffb5 0xffffffb5 0xffffffb5 0xffffffb5 0xffffffb5 0xffffffb5 0xffffffb5 0xffffffb5 0xffffffb5 0xffffffb5 0xffffffb5 0xffffffb5 0xffffffb5 0xffffffb5 0xffffffb5 0xffffffb5 0xffffffb5 0xffffffb5 0xffffffb5 0xffffffb5 0xffffffb5 0xffffffb5 0xffffffb5 0xffffffb5 0xffffffb5 0xffffffb5 0xffffffb5 0xffffffb5 0xffffffb5 0xffffffb5 0xffffffb5 0xffffffb5 0xffffffb5 0xffffffb5 0xffffffb5 0xffffffb5 0xffffffb5 0xffffffb5 0xffffffb5 0xffffffb5 0xffffffb5 0xffffffb5 0xffffffb5 0xffffffb5 0xffffffb5 0xffffffb5 0xffffffb5 0xffffffb5 0xffffffb5 0xffffffb5 0xffffffb5 0xffffffb5 0xffffffb5 0xffffffb5 0xffffffb5 0xffffffb5 0xffffffb5 0xffffffb5 0xffffffb5 0xffffffb5 0xffffffb5 0xffffffb5 0xffffffb5 0xffffffb5 0xffffffb5 0xffffffb5 0xffffffb5 0xffffffb5 0xffffffb5 0xffffffb5 0xffffffb5 0xffffffb5 0xffffffb5 0xffffffb5 0xffffffb5 0xffffffb5 0xffffffb5 0xffffffb5 0xffffffb5 0xffffffb5 0xffffffb5 0xffffffb5 0xffffffb5 0xffffffb5 0xffffffb5 0xffffffb5 0xffffffb5 0xffffffb5 0xffffffb5 0xffffffb5 0xffffffb5 0xffffffb5 0xffffffb5 0xffffffb5 0xffffffb5 0xffffffb5 0xffffffb5 0xffffffb5 0xffffffb5 0xffffffb5 0xffffffb5 0xffffffb5 0xffffffb5 0xffffffb5 0xffffffb5 0xffffffb5 0xffffffb5 0xffffffb5 0xffffffb5 0xffffffb5 0xffffffb5 0xffffffb5 0xffffffb5 0xffffffb5 0xffffffb5 0xffffffb5 0xffffffb5 0xffffffb5 0xffffffb5 0xffffffb5 0xffffffb5 0xffffffb5 0xffffffb5 0xffffffb5 0xffffffb5 0xffffffb5 0xffffffb5 0xffffffb5 0xffffffb5 0xffffffb5 0xffffffb5 0xffffffb5 0xffffffb5 0xffffffb5 0xffffffb5 0xffffffb5 0xffffffb5 0xffffffb5 0xffffffb5 0xffffffb5 0xffffffb5 0xffffffb5 0xffffffb5 0xffffffb5 0xffffffb5 0xffffffb5 0xffffffb5 0xffffffb5 0xffffffb5 0xffffffb5 0xffffffb5 0xffffffb5 0xffffffb5 0xffffffb5 0xffffffb5 0xffffffb5 0xffffffb5 0xffffffb5 0xffffffb5 0xffffffb5 0xffffffb5 0xffffffb5 0xffffffb5 0xffffffb5 0xffffffb5 0xffffffb5 0xffffffb5 0xffffffb5 0xffffffb5 0xffffffb5 0xffffffb5 0xffffffb5 0xffffffb5 0xffffffb5 0xffffffb5 0xffffffb5 0xffffffb5 0xffffffb5 0xffffffb5 0xffffffb5 0xffffffb5 0xffffffb5 0xffffffb5 0xffffffb5 0xffffffb5 0xffffffb5 0xffffffb5 0xffffffb5 0xffffffb5 0xffffffb5 0xffffffb5 0xffffffb5 0xffffffb5 0xffffffb5 0xffffffb5 0xffffffb5 0xffffffb5 0xffffffb5 0xffffffb5 0xffffffb5 0xffffffb5 0xffffffb5 0xffffffb5 0xffffffb5 0xffffffb5 0xffffffb5 0xffffffb5 0xffffffb5 0xffffffb5 0xffffffb5 0xffffffb5 0xffffffb5 0xffffffb5 0xffffffb5 0xffffffb5 0xffffffb5 0xffffffb5 0xffffffb5 0xffffffb5 0xffffffb5 0xffffffb5 0xffffffb5 0xffffffb5 0xffffffb5 0xffffffb5 0xffffffb5 0xffffffb5 0xffffffb5 0xffffffb5 0xffffffb5 0xffffffb5 0xffffffb5 0xffffffb5 0xffffffb5 0xffffffb5 0xffffffb5 0xffffffb5 0xffffffb5 0xffffffb5 0xffffffb5 0xffffffb5 0xffffffb5 0xffffffb5 0xffffffb5 0xffffffb5 0xffffffb5 0xffffffb5 0xffffffb5 0xffffffb5 0xffffffb5 0xffffffb5 0xffffffb5 0xffffffb5 0xffffffb5 0xffffffb5 0xffffffb5 0xffffffb5 0xffffffb5 0xffffffb5 0xffffffb5 0xffffffb5 0xffffffb5 0xffffffb5 0xffffffb5 0xffffffb5 0xffffffb5 0xffffffb5 0xffffffb5 0xffffffb5 0xffffffb5 0xffffffb5 0xffffffb5 0xffffffb5 0xffffffb5 0xffffffb5 0xffffffb5 0xffffffb5 0xffffffb5 0xffffffb5 0xffffffb5 0xffffffb5 0xffffffb5 0xffffffb5 0xffffffb5 0xffffffb5 0xffffffb5 0xffffffb5 0xffffffb5 0xffffffb5 0xffffffb5 0xffffffb5 0xffffffb5 0xffffffb5 0xffffffb5 0xffffffb5 0xffffffb5 0xffffffb5 0xffffffb5 0xffffffb5 0xffffffb5 0xffffffb5 0xffffffb5 0xffffffb5 0xffffffb5 0xffffffb5 0xffffffb5 0xffffffb5 0xffffffb5 0xffffffb5 0xffffffb5 0xffffffb5 0xffffffb5 0xffffffb5 0xffffffb5 0xffffffb5 0xffffffb5 0xffffffb5 0xffffffb5 0xffffffb5 0xffffffb5 0xffffffb5 0xffffffb5 0xffffffb5 0xffffffb5 0xffffffb5 0xffffffb5 0xffffffb5 0xffffffb5 0xffffffb5 0xffffffb5 0xffffffb5 0xffffffb5 0xffffffb5 0xffffffb5 0xffffffb5 0xffffffb5 0xffffffb5 0xffffffb5 0xffffffb5 0xffffffb5 0xffffffb5 0xffffffb5 0xffffffb5 0xffffffb5 0xffffffb5 0xffffffb5 0xffffffb5 0xffffffb5 0xffffffb5 0xffffffb5 0xffffffb5 0xffffffb5 0xffffffb5 0xffffffb5 0xffffffb5 0xffffffb5 0xffffffb5 0xffffffb5 0xffffffb5 0xffffffb5 0xffffffb5 0xffffffb5 0xffffffb5 0xffffffb5 0xffffffb5 0xffffffb5 0xffffffb5 0xffffffb5 0xffffffb5 0xffffffb5 0xffffffb5 0xffffffb5 0xffffffb5 0xffffffb5 0xffffffb5 0xffffffb5 0xffffffb5 0xffffffb5 0xffffffb5 0xffffffb5 0xffffffb5 0xffffffb5 0xffffffb5 0xffffffb5 0xffffffb5 0xffffffb5 0xffffffb5 0xffffffb5 0xffffffb5 0xffffffb5 0xffffffb5 0xffffffb5 0xffffffb5 0xffffffb5 0xffffffb5 0xffffffb5 0xffffffb5 0xffffffb5 0xffffffb5 0xffffffb5 0xffffffb5 0xffffffb5 0xffffffb5 0xffffffb5 0xffffffb5 0xffffffb5 0xffffffb5 0xffffffb5 0xffffffb5 0xffffffb5 0xffffffb5 0xffffffb5 0xffffffb5 0xffffffb5 0xffffffb5 0xffffffb5 0xffffffb5 0xffffffb5 0xffffffb5 0xffffffb5 0xffffffb5 0xffffffb5 0xffffffb5 0xffffffb5 0xffffffb5 0xffffffb5 0xffffffb5 0xffffffb5 0xffffffb5 0xffffffb5 0xffffffb5 0xffffffb5 0xffffffb5 0xffffffb5 0xffffffb5 0xffffffb5 0xffffffb5 0xffffffb5 0xffffffb5 0xffffffb5 0xffffffb5 0xffffffb5 0xffffffb5 0xffffffb5 0xffffffb5 0xffffffb5 0xffffffb5 0xffffffb5 0xffffffb5 0xffffffb5 0xffffffb5 0xffffffb5 0xffffffb5 0xffffffb5 0xffffffb5 0xffffffb5 0xffffffb5 0xffffffb5 0xffffffb5 0xffffffb5 0xffffffb5 0xffffffb5 0xffffffb5 0xffffffb5 0xffffffb5 0xffffffb5 0xffffffb5 0xffffffb5 0xffffffb5 0xffffffb5 0xffffffb5 0xffffffb5 0xffffffb5 0xffffffb5 0xffffffb5 0xffffffb5 0xffffffb5 0xffffffb5 0xffffffb5 0xffffffb5 0xffffffb5 0xffffffb5 0xffffffb5 0xffffffb5 0xffffffb5 0xffffffb5 0xffffffb5 0xffffffb5 0xffffffb5 0xffffffb5 0xffffffb5 0xffffffb5 0xffffffb5 0xffffffb5 0xffffffb5 0xffffffb5 0xffffffb5 0xffffffb5 0xffffffb5 0xffffffb5 0xffffffb5 0xffffffb5 0xffffffb5 0xffffffb5 0xffffffb5 0xffffffb5 0xffffffb5 0xffffffb5 0xffffffb5 0xffffffb5 0xffffffb5 0xffffffb5 0xffffffb5 0xffffffb5 0xffffffb5 0xffffffb5 0xffffffb5 0xffffffb5 0xffffffb5 0xffffffb5 0xffffffb5 0xffffffb5 0xffffffb5 0xffffffb5 0xffffffb5 0xffffffb5 0xffffffb5 0xffffffb5 0xffffffb5 0xffffffb5 0xffffffb5 0xffffffb5 0xffffffb5 0xffffffb5 0xffffffb5>;
				PS_Config_Diff_Test_Frame = <0x32>;
			};
		};
	};

	fragment@61 {
		target = <&ts_focal>;

		__overlay__ {
			compatible = "focaltech,fts";
			status = "ok";
			spi-max-frequency = "", "=\t";
			focaltech,reset-gpio = <&pio>, <0x0f 0x00>;
			focaltech,irq-gpio = <&pio>, <0x0e 0x2002>;
			focaltech,max-touch-number = <0x0a>;
			focaltech,display-coords = <0x00 0x00 0x438 0x924>;
		};
	};

	fragment@62 {
		target = <&thermal_message>;

		__overlay__ {
			board-sensor = "VIRTUAL-SENSOR";
		};
	};

	fragment@63 {
		target = <&xiaomi_touch>;

		__overlay__ {
			status = "ok";
			compatible = "xiaomi-touch";
			touch,name = "xiaomi-touch";
		};
	};

	fragment@64 {
		target = <&odm>;

		__overlay__ {

			simtray {
				compatible = "xiaomi,simtray-status";
				status-gpio = <&pio>, <0x4d 0x00>;
			};

			testing-mode {
				compatible = "xiaomi,testing-mode";
				status-gpio = <&pio>, <0x21 0x00>;
				debounce-time = <0x1e>;
				pinctrl-names = "default";
				pinctrl-0 = <&test_mode_irq>;
			};
		};
	};

};
